#include <Arduino.h>
#include <WiFi.h>
#include <WiFiClientSecure.h>
#include <UniversalTelegramBot.h>
#include <ArduinoJson.h>
#include <U8g2lib.h>
#include <Wire.h>

// WiFi
const char* WIFI_SSID = "OnePlus Nord CE 3 Lite 5G";
const char* WIFI_PASSWORD = "w5cuke7u";

U8G2_SH1106_128X64_NONAME_F_HW_I2C u8g2(U8G2_R0,U8X8_PIN_NONE);

// Telegram
#define BOT_TOKEN "8822857236:AAH4FwPWFah3DW7rUeppIPC3Ddj-Zgiuhpc"
const char* CHANNEL_ID = "-1004468259020";

WiFiClientSecure client;
UniversalTelegramBot bot(BOT_TOKEN, client);

// 'Emergency_icon'
const unsigned char bitmap_Emergency_icon [] PROGMEM = {
	0x00, 0x00, 0x00, 0x00, 0xc0, 0x03, 0xe0, 0x07, 0xf0, 0x0f, 0x70, 0x0e, 0x70, 0x0e, 0x10, 0x08, 
	0x10, 0x08, 0x70, 0x0e, 0x70, 0x0e, 0xf0, 0x0f, 0x00, 0x00, 0xfc, 0x3f, 0xfc, 0x3f, 0x00, 0x00
};
// 'game_icon'
const unsigned char bitmap_game_icon [] PROGMEM = {
	0x00, 0x00, 0x00, 0x00, 0xf0, 0x0f, 0x08, 0x10, 0x24, 0x24, 0x72, 0x4a, 0x22, 0x44, 0xc2, 0x43, 
	0x22, 0x44, 0x12, 0x48, 0x12, 0x48, 0x12, 0x48, 0x0c, 0x30, 0x00, 0x00, 0x00, 0x00, 0x00, 0x00
};
// 'reminder_logo'
const unsigned char bitmap_reminder_logo [] PROGMEM = {
	0x00, 0x00, 0x00, 0x00, 0x80, 0x01, 0xc0, 0x03, 0xe0, 0x07, 0xe0, 0x07, 0xe0, 0x07, 0xf0, 0x0f, 
	0xf8, 0x1f, 0xf8, 0x1f, 0xf0, 0x0f, 0x00, 0x00, 0x40, 0x02, 0x80, 0x01, 0x00, 0x00, 0x00, 0x00
};
// 'setting_logo'
const unsigned char bitmap_setting_logo [] PROGMEM = {
	0x00, 0x00, 0x00, 0x00, 0x98, 0x0f, 0xd8, 0x1f, 0xd8, 0x18, 0xd8, 0x18, 0x18, 0x18, 0x18, 0x18, 
	0x18, 0x1c, 0x18, 0x0e, 0x18, 0x07, 0x00, 0x00, 0x98, 0x01, 0x98, 0x01, 0x00, 0x00, 0x00, 0x00
};
// 'yoga_icon'
const unsigned char bitmap_yoga_icon [] PROGMEM = {
	0x00, 0x00, 0x40, 0x02, 0x20, 0x04, 0x90, 0x09, 0xa0, 0x05, 0x40, 0x02, 0x00, 0x01, 0x00, 0x01, 
	0x00, 0x01, 0x00, 0x01, 0x80, 0x02, 0x80, 0x04, 0x80, 0x02, 0x80, 0x00, 0x80, 0x00, 0x00, 0x00
};

const unsigned char* bitmap_icons[5] = {
	bitmap_game_icon,
  bitmap_yoga_icon,
  bitmap_reminder_logo,
  bitmap_Emergency_icon,
	bitmap_setting_logo
};

// 'scrollbar_background', 8x64px
const unsigned char bitmap_scrollbar_background [] PROGMEM = {
  0x00, 0x40, 0x00, 0x40, 0x00, 0x40, 0x00, 0x40, 0x00, 0x40, 0x00, 0x40, 
  0x00, 0x40, 0x00, 0x40, 0x00, 0x40, 0x00, 0x40, 0x00, 0x40, 0x00, 0x40, 
  0x00, 0x40, 0x00, 0x40, 0x00, 0x40, 0x00, 0x40, 0x00, 0x40, 0x00, 0x40, 
  0x00, 0x40, 0x00, 0x40, 0x00, 0x40, 0x00, 0x40, 0x00, 0x40, 0x00, 0x40, 
  0x00, 0x40, 0x00, 0x40, 0x00, 0x40, 0x00, 0x40, 0x00, 0x40, 0x00, 0x40, 
  0x00, 0x40, 0x00, 0x00, };


// 'item_sel_outline', 128x21px
const unsigned char bitmap_item_sel_outline [] PROGMEM = {
  0xF8, 0xFF, 0xFF, 0xFF, 0xFF, 0xFF, 0xFF, 0xFF, 0xFF, 0xFF, 0xFF, 0xFF, 
  0xFF, 0xFF, 0xFF, 0x03, 0x04, 0x00, 0x00, 0x00, 0x00, 0x00, 0x00, 0x00, 
  0x00, 0x00, 0x00, 0x00, 0x00, 0x00, 0x00, 0x04, 0x02, 0x00, 0x00, 0x00, 
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  0xFF, 0xFF, 0xFF, 0xFF, 0xFF, 0xFF, 0xFF, 0xFF, 0xFF, 0xFF, 0xFF, 0x03, 
  };

const int NUM_ITEMS = 5; // number of items in the list and also the number of screenshots and screenshots with QR codes (other screens)
const int MAX_ITEM_LENGTH = 20; // maximum characters for the item name

char menu_items [NUM_ITEMS] [MAX_ITEM_LENGTH] = {  // array with item names
  { "Game" }, 
  { "Exercise" }, 
  { "Reminder" }, 
  { "Emergency" }, 
  { "Setting" }
 };


 //YOGA BITMAPS//
 // 'YOGA3L1', 64x64px
const unsigned char bitmap_YOGA3L1 [] PROGMEM = {
	0x00, 0x00, 0x00, 0x00, 0x00, 0x00, 0x00, 0x00, 0x00, 0x00, 0x00, 0x00, 0x00, 0x00, 0x00, 0x00, 
	0x00, 0x00, 0x00, 0x00, 0x00, 0x00, 0x00, 0x00, 0x00, 0x00, 0x00, 0x00, 0x00, 0x00, 0x00, 0x00, 
	0x00, 0x00, 0x00, 0x00, 0x00, 0x00, 0x00, 0x00, 0x00, 0x00, 0x00, 0x00, 0x00, 0x00, 0x00, 0x00, 
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	0x00, 0x00, 0x00, 0x00, 0x00, 0x00, 0x00, 0x00, 0x00, 0x00, 0x00, 0x00, 0x00, 0x00, 0x00, 0x00
};
// 'YOGA2L1', 64x64px
const unsigned char bitmap_YOGA2L1 [] PROGMEM = {
	0x00, 0x00, 0x00, 0x00, 0x00, 0x00, 0x00, 0x00, 0x00, 0x00, 0x00, 0x00, 0x00, 0x00, 0x00, 0x00, 
	0x00, 0x00, 0x00, 0x00, 0x00, 0x00, 0x00, 0x00, 0x00, 0x00, 0x00, 0x00, 0x00, 0x00, 0x00, 0x00, 
	0x00, 0x00, 0x00, 0x00, 0x00, 0x00, 0x00, 0x00, 0x00, 0x00, 0x00, 0x00, 0x00, 0x00, 0x00, 0x00, 
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	0x00, 0x00, 0x00, 0x00, 0x00, 0x00, 0x00, 0x00, 0x00, 0x00, 0x00, 0x00, 0x00, 0x00, 0x00, 0x00
};
// 'YOGA3R2', 64x64px
const unsigned char bitmap_YOGA3R2 [] PROGMEM = {
	0x00, 0x00, 0x00, 0x00, 0x00, 0x00, 0x00, 0x00, 0x00, 0x00, 0x00, 0x00, 0x00, 0x00, 0x00, 0x00, 
	0x00, 0x00, 0x00, 0x00, 0x00, 0x00, 0x00, 0x00, 0x00, 0x00, 0x00, 0x00, 0x00, 0x00, 0x00, 0x00, 
	0x00, 0x00, 0x00, 0x00, 0x00, 0x00, 0x00, 0x00, 0x00, 0x00, 0x00, 0x00, 0x00, 0x00, 0x00, 0x00, 
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	0x00, 0x00, 0x00, 0x00, 0x00, 0x00, 0x00, 0x00, 0x00, 0x00, 0x00, 0x00, 0x00, 0x00, 0x00, 0x00
};
// 'YOGA2R2', 64x64px
const unsigned char bitmap_YOGA2R2 [] PROGMEM = {
	0x00, 0x00, 0x00, 0x00, 0x00, 0x00, 0x00, 0x00, 0x00, 0x00, 0x00, 0x00, 0x00, 0x00, 0x00, 0x00, 
	0x00, 0x00, 0x00, 0x00, 0x00, 0x00, 0x00, 0x00, 0x00, 0x00, 0x00, 0x00, 0x00, 0x00, 0x00, 0x00, 
	0x00, 0x00, 0x00, 0x00, 0x00, 0x00, 0x00, 0x00, 0x00, 0x00, 0x00, 0x00, 0x00, 0x00, 0x00, 0x00, 
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	0x00, 0x00, 0x00, 0x00, 0x00, 0x00, 0x00, 0x00, 0x00, 0x00, 0x00, 0x00, 0x00, 0x00, 0x00, 0x00
};
// 'YOGA2L2', 64x64px
const unsigned char bitmap_YOGA2L2 [] PROGMEM = {
	0x00, 0x00, 0x00, 0x00, 0x00, 0x00, 0x00, 0x00, 0x00, 0x00, 0x00, 0x00, 0xc0, 0x03, 0x00, 0x00, 
	0x00, 0x00, 0x00, 0x00, 0xc0, 0x07, 0x00, 0x00, 0x00, 0x00, 0x06, 0x00, 0xe0, 0x07, 0x00, 0x00, 
	0x00, 0x00, 0x0f, 0x00, 0xe0, 0x07, 0x00, 0x00, 0x00, 0x80, 0x1f, 0x00, 0xe0, 0x07, 0x00, 0x00, 
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	0x00, 0x00, 0x00, 0xfe, 0xff, 0x03, 0x00, 0x00, 0x00, 0x00, 0x00, 0xfe, 0xff, 0x03, 0x00, 0x00
};
// 'YOGA1R2', 64x64px
const unsigned char bitmap_YOGA1R2 [] PROGMEM = {
	0x00, 0x00, 0x00, 0x00, 0x00, 0x00, 0x00, 0x00, 0x00, 0x00, 0x00, 0x00, 0x00, 0x00, 0x00, 0x00, 
	0x00, 0x00, 0x00, 0x00, 0x00, 0x00, 0x00, 0x00, 0x00, 0x00, 0x00, 0x00, 0x0f, 0x3c, 0x00, 0x00, 
	0x00, 0x00, 0x00, 0x80, 0xbf, 0x7f, 0x00, 0x00, 0x00, 0x00, 0x00, 0xc0, 0xff, 0xff, 0x07, 0x00, 
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	0x00, 0x00, 0x00, 0x00, 0xf8, 0xff, 0xff, 0x01, 0x00, 0x00, 0x00, 0x00, 0xf8, 0xff, 0xff, 0x01
};
// 'YOGA3L2', 64x64px
const unsigned char bitmap_YOGA3L2 [] PROGMEM = {
	0x00, 0x00, 0x00, 0x00, 0x00, 0x00, 0x00, 0x00, 0x00, 0x00, 0x00, 0x00, 0x00, 0x00, 0x00, 0x00, 
	0x00, 0x00, 0x00, 0x00, 0x00, 0x00, 0x00, 0x00, 0x00, 0x00, 0x00, 0x00, 0x00, 0x00, 0x00, 0x00, 
	0x00, 0x00, 0x00, 0x30, 0x00, 0x00, 0x00, 0x00, 0x00, 0x00, 0x00, 0x70, 0x00, 0x00, 0x00, 0x00, 
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	0x00, 0x00, 0x00, 0x00, 0x00, 0x00, 0x00, 0x00, 0x00, 0x00, 0x00, 0x00, 0x00, 0x00, 0x00, 0x00
};
// 'YOGA1R1', 64x64px
const unsigned char bitmap_YOGA1R1 [] PROGMEM = {
	0x00, 0x00, 0x00, 0x00, 0x00, 0x00, 0x00, 0x00, 0x00, 0x00, 0x00, 0x00, 0x00, 0xc0, 0x01, 0x00, 
	0x00, 0x00, 0x00, 0x00, 0x00, 0xe0, 0x03, 0x00, 0x00, 0x00, 0x00, 0x00, 0x00, 0xe0, 0x03, 0x00, 
	0x00, 0x00, 0x00, 0x00, 0x00, 0xe0, 0x03, 0x00, 0x00, 0x00, 0x00, 0x00, 0x00, 0xe0, 0x03, 0x00, 
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	0x00, 0x00, 0x00, 0xfc, 0xff, 0x7f, 0x00, 0x00, 0x00, 0x00, 0x00, 0xfc, 0xff, 0x7f, 0x00, 0x00
};
// 'YOGA1L1', 64x64px
const unsigned char bitmap_YOGA1L1 [] PROGMEM = {
	0x00, 0x00, 0x00, 0x00, 0x00, 0x00, 0x00, 0x00, 0x00, 0x00, 0x00, 0x00, 0x00, 0x00, 0x00, 0x00, 
	0x00, 0x00, 0x00, 0x00, 0x00, 0x00, 0x00, 0x00, 0x00, 0x00, 0x3c, 0xf0, 0x00, 0x00, 0x00, 0x00, 
	0x00, 0x00, 0xfe, 0xfd, 0x01, 0x00, 0x00, 0x00, 0x00, 0xe0, 0xff, 0xff, 0x03, 0x00, 0x00, 0x00, 
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	0x80, 0xff, 0xff, 0x1f, 0x00, 0x00, 0x00, 0x00, 0x80, 0xff, 0xff, 0x1f, 0x00, 0x00, 0x00, 0x00
};
// 'YOGA3R1', 64x64px
const unsigned char bitmap_YOGA3R1 [] PROGMEM = {
	0x00, 0x00, 0x00, 0x00, 0x00, 0x00, 0x00, 0x00, 0x00, 0x00, 0x00, 0x00, 0x00, 0x00, 0x00, 0x00, 
	0x00, 0x00, 0x00, 0x00, 0x00, 0x00, 0x00, 0x00, 0x00, 0x00, 0x00, 0x00, 0x00, 0x00, 0x00, 0x00, 
	0x00, 0x00, 0x00, 0x00, 0x0c, 0x00, 0x00, 0x00, 0x00, 0x00, 0x00, 0x00, 0x0e, 0x00, 0x00, 0x00, 
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	0x00, 0x00, 0x00, 0x00, 0x00, 0x00, 0x00, 0x00, 0x00, 0x00, 0x00, 0x00, 0x00, 0x00, 0x00, 0x00
};
// 'YOGA2R1', 64x64px
const unsigned char bitmap_YOGA2R1 [] PROGMEM = {
	0x00, 0x00, 0x00, 0x00, 0x00, 0x00, 0x00, 0x00, 0x00, 0x00, 0xe0, 0x03, 0x00, 0x00, 0x00, 0x00, 
	0x00, 0x00, 0xe0, 0x03, 0x00, 0x00, 0x00, 0x00, 0x00, 0x00, 0xe0, 0x07, 0x00, 0x60, 0x00, 0x00, 
	0x00, 0x00, 0xe0, 0x07, 0x00, 0xf0, 0x00, 0x00, 0x00, 0x00, 0xe0, 0x07, 0x00, 0xf0, 0x01, 0x00, 
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	0x00, 0x00, 0xc0, 0xff, 0x7f, 0x00, 0x00, 0x00, 0x00, 0x00, 0xc0, 0xff, 0x7f, 0x00, 0x00, 0x00
};
// 'YOGA1L2', 64x64px
const unsigned char bitmap_YOGA1L2 [] PROGMEM = {
	0x00, 0x00, 0x00, 0x00, 0x00, 0x00, 0x00, 0x00, 0x00, 0x80, 0x03, 0x00, 0x00, 0x00, 0x00, 0x00, 
	0x00, 0xc0, 0x07, 0x00, 0x00, 0x00, 0x00, 0x00, 0x00, 0xc0, 0x07, 0x00, 0x00, 0x00, 0x00, 0x00, 
	0x00, 0xc0, 0x07, 0x00, 0x00, 0x00, 0x00, 0x00, 0x00, 0xc0, 0x07, 0x00, 0x00, 0x00, 0x00, 0x00, 
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	0x00, 0x00, 0xfe, 0xff, 0x3f, 0x00, 0x00, 0x00, 0x00, 0x00, 0xfe, 0xff, 0x3f, 0x00, 0x00, 0x00
};

// Array of all bitmaps for convenience. (Total bytes used to store images in PROGMEM = 6336)
const int YOGA_LEN = 12;
const unsigned char* YOGA[YOGA_LEN] = {
	bitmap_YOGA1L1,
  bitmap_YOGA1R1,
	bitmap_YOGA1L2,
	bitmap_YOGA1R2,
	bitmap_YOGA2L1,
  bitmap_YOGA2R1,
	bitmap_YOGA2L2,
	bitmap_YOGA2R2,
	bitmap_YOGA3L1,
  bitmap_YOGA3R2,
	bitmap_YOGA3L2,
	bitmap_YOGA3R1
};



// -------------------- BUTTON / NAVIGATION --------------------

#define BUTTON_UP_PIN     18
#define BUTTON_SELECT_PIN 19
#define BUTTON_DOWN_PIN   23
#define BUTTON_LEFT_PIN   26
#define BUTTON_RIGHT_PIN  27
#define BUZZER_PIN        25

// Main menu
int button_up_clicked = 0;
int button_select_clicked = 0;
int button_down_clicked = 0;
int button_left_clicked = 0;

int item_selected = 0;
int item_sel_previous = 0;
int item_sel_next = 0;

// 0 = main menu, 1 = game submenu, 2 = yoga submenu, 3 = emergency
int current_screen = 0;

// Game submenu
const int GAME_NUM_ITEMS = 3;
const int GAME_MAX_ITEM_LENGTH = 20;

char game_menu_items[GAME_NUM_ITEMS][GAME_MAX_ITEM_LENGTH] = {
  "Game 1",
  "Game 2",
  "Game 3"
};

int game_button_up_clicked = 0;
int game_button_select_clicked = 0;
int game_button_down_clicked = 0;
int game_item_selected = 0;
int game_item_sel_previous = 0;
int game_item_sel_next = 0;

// 0 = game menu
int game_current_screen = 0;

// Yoga submenu
const int YOGA_NUM_ITEMS = 3;
const int YOGA_MAX_ITEM_LENGTH = 20;

char yoga_menu_items[YOGA_NUM_ITEMS][YOGA_MAX_ITEM_LENGTH] = {
  "Yoga 1",
  "Yoga 2",
  "Yoga 3"
};

int yoga_button_up_clicked = 0;
int yoga_button_select_clicked = 0;
int yoga_button_down_clicked = 0;
int yoga_button_left_clicked = 0;

int yoga_item_selected = 0;
int yoga_item_sel_previous = 0;
int yoga_item_sel_next = 0;

// 0 = yoga menu, 1 = yoga 1 animation, 2 = yoga 2,
// 3 = yoga 3
int yoga_current_screen = 0;

// Yoga animation
unsigned long lastFrameTime = 0;
const unsigned long FRAME_INTERVAL = 1000;
bool currentFrame = false;

// -------------------- EMERGENCY --------------------

int eg_button_down_clicked = 0;
int eg_button_up_clicked = 0;
int eg_button_select_clicked = 0;

int selected = 0;

String messages[] = {
  "Medical Emergency - Need help now!",
  "Fall Detected - Please check on me",
  "Need Assistance - Not urgent",
  "I'm OK - Just checking in"
};

const int messageCount = 4;

// Emergency button debounce
unsigned long lastButtonTime = 0;
const unsigned long debounceTime = 250;

// -------------------- LEFT/BACK LONG PRESS --------------------

// Non-blocking long-press handling.
// A long press is handled only once, after the button has been held
// for LONG_PRESS_TIME milliseconds.
bool leftPressActive = false;
bool leftLongPressHandled = false;
unsigned long leftPressStart = 0;
const unsigned long LONG_PRESS_TIME = 1000;

// -------------------- HELPERS --------------------

void resetInputFlags() {
  button_up_clicked = 0;
  button_select_clicked = 0;
  button_down_clicked = 0;
  button_left_clicked = 0;

  game_button_up_clicked = 0;
  game_button_select_clicked = 0;
  game_button_down_clicked = 0;

  yoga_button_up_clicked = 0;
  yoga_button_select_clicked = 0;
  yoga_button_down_clicked = 0;
  yoga_button_left_clicked = 0;

  eg_button_up_clicked = 0;
  eg_button_down_clicked = 0;
  eg_button_select_clicked = 0;
}

void drawMainMenu() {
  item_sel_previous = item_selected - 1;
  if (item_sel_previous < 0) item_sel_previous = NUM_ITEMS - 1;

  item_sel_next = item_selected + 1;
  if (item_sel_next >= NUM_ITEMS) item_sel_next = 0;

  u8g2.clearBuffer();

  u8g2.drawXBMP(0, 22, 128, 21, bitmap_item_sel_outline);

  u8g2.setFont(u8g_font_7x14);
  u8g2.drawStr(25, 15, menu_items[item_sel_previous]);
  u8g2.drawXBMP(4, 2, 16, 16, bitmap_icons[item_sel_previous]);

  u8g2.setFont(u8g_font_7x14B);
  u8g2.drawStr(25, 37, menu_items[item_selected]);
  u8g2.drawXBMP(4, 24, 16, 16, bitmap_icons[item_selected]);

  u8g2.setFont(u8g_font_7x14);
  u8g2.drawStr(25, 57, menu_items[item_sel_next]);
  u8g2.drawXBMP(4, 46, 16, 16, bitmap_icons[item_sel_next]);

  u8g2.drawXBMP(120, 0, 8, 64, bitmap_scrollbar_background);
  u8g2.drawBox(125, (64 / NUM_ITEMS) * item_selected, 3, 64 / NUM_ITEMS);

  u8g2.sendBuffer();
}

void drawGameMenu() {

  u8g2.clearBuffer();

  u8g2.drawXBMP(0,(64 / GAME_NUM_ITEMS) * game_item_selected,128, 21,bitmap_item_sel_outline);

  u8g2.setFont(u8g_font_7x14B);
  u8g2.drawStr(25, 15, game_menu_items[0]);

  u8g2.setFont(u8g_font_7x14B);
  u8g2.drawStr(25, 37, game_menu_items[1]);

  u8g2.setFont(u8g_font_7x14B);
  u8g2.drawStr(25, 57, game_menu_items[2]);

  u8g2.drawXBMP(120, 0, 8, 64, bitmap_scrollbar_background);
  u8g2.drawBox(125,(64 / GAME_NUM_ITEMS) * game_item_selected,3,64 / GAME_NUM_ITEMS);

  u8g2.sendBuffer();
}

void drawYogaMenu() {

  u8g2.clearBuffer();

  u8g2.drawXBMP(0,(64 / YOGA_NUM_ITEMS) * yoga_item_selected,128, 21,bitmap_item_sel_outline );

  u8g2.setFont(u8g_font_7x14B);
  u8g2.drawStr(25, 15, yoga_menu_items[0]);

  u8g2.setFont(u8g_font_7x14B);
  u8g2.drawStr(25, 37, yoga_menu_items[1]);

  u8g2.setFont(u8g_font_7x14B);
  u8g2.drawStr(25, 57, yoga_menu_items[2]);

  u8g2.drawXBMP(120, 0, 8, 64, bitmap_scrollbar_background);
  u8g2.drawBox(125,(64 / YOGA_NUM_ITEMS) * yoga_item_selected,3, 64 / YOGA_NUM_ITEMS);

  u8g2.sendBuffer();
}

void drawYoga1() {

  u8g2.clearBuffer();

  if (currentFrame == 0) {
    u8g2.drawXBMP(0, 0, 64, 64, YOGA[0]);
    u8g2.drawXBMP(64, 0, 64, 64, YOGA[1]);
  } else {
    u8g2.drawXBMP(0, 0, 64, 64, YOGA[2]);
    u8g2.drawXBMP(64, 0, 64, 64, YOGA[3]);
  }

  u8g2.sendBuffer();
}

void drawYoga2() {
  
  u8g2.clearBuffer();

  if (currentFrame == 0) {
    u8g2.drawXBMP(0, 0, 64, 64, YOGA[4]);
    u8g2.drawXBMP(64, 0, 64, 64, YOGA[5]);
  } else {
    u8g2.drawXBMP(0, 0, 64, 64, YOGA[6]);
    u8g2.drawXBMP(64, 0, 64, 64, YOGA[7]);
  }

  u8g2.sendBuffer();
}

void drawYoga3() {
  
  u8g2.clearBuffer();

  if (currentFrame == 0) {
    u8g2.drawXBMP(0, 0, 64, 64, YOGA[8]);
    u8g2.drawXBMP(64, 0, 64, 64, YOGA[9]);
  } else {
    u8g2.drawXBMP(0, 0, 64, 64, YOGA[10]);
    u8g2.drawXBMP(64, 0, 64, 64, YOGA[11]);
  }

  u8g2.sendBuffer();
}

void drawEmergencyScreen() {
  u8g2.clearBuffer();

  u8g2.setFont(u8g2_font_6x10_tr);

  u8g2.drawBox(0, 0, 128, 14);
  u8g2.setDrawColor(0);
  u8g2.drawStr(18, 11, "EMERGENCY ALERT");
  u8g2.setDrawColor(1);

  u8g2.drawRFrame(2, 17, 124, 29, 3);

  if (selected == 0) {
    u8g2.drawStr(14, 29, "Medical Emergency");
    u8g2.drawStr(22, 41, "Need help now!");
  }
  else if (selected == 1) {
    u8g2.drawStr(22, 29, "Fall Detected");
    u8g2.drawStr(12, 41, "Please check on me");
  }
  else if (selected == 2) {
    u8g2.drawStr(18, 29, "Need Assistance");
    u8g2.drawStr(30, 41, "Not urgent");
  }
  else {
    u8g2.drawStr(36, 29, "I'm OK");
    u8g2.drawStr(18, 41, "Just checking in");
  }

  u8g2.drawTriangle(26, 56, 32, 50, 32, 62);
  u8g2.drawTriangle(102, 56, 96, 50, 96, 62);

  u8g2.drawRBox(38, 48, 52, 15, 3);
  u8g2.setDrawColor(0);
  u8g2.drawStr(52, 60, "SEND");
  u8g2.setDrawColor(1);

  u8g2.sendBuffer();
}

// -------------------- SETUP --------------------

void setup() {
  Serial.begin(115200);

  // Classic ESP32 I2C pins:
  Wire.begin(21, 22);

  u8g2.begin();
  u8g2.setDrawColor(1);
  u8g2.setBitmapMode(1);

  pinMode(BUTTON_UP_PIN, INPUT_PULLUP);
  pinMode(BUTTON_SELECT_PIN, INPUT_PULLUP);
  pinMode(BUTTON_DOWN_PIN, INPUT_PULLUP);
  pinMode(BUTTON_LEFT_PIN, INPUT_PULLUP);
  pinMode(BUTTON_RIGHT_PIN, INPUT_PULLUP);
  pinMode(BUZZER_PIN, OUTPUT);

  client.setInsecure();

  WiFi.begin(WIFI_SSID, WIFI_PASSWORD);
  Serial.print("Connecting to WiFi");

  // Do not block the entire device forever if WiFi is unavailable.
  unsigned long wifiStart = millis();
  const unsigned long WIFI_TIMEOUT = 15000;

  while (WiFi.status() != WL_CONNECTED &&
         millis() - wifiStart < WIFI_TIMEOUT) {
    delay(250);
    Serial.print(".");
  }

  Serial.println();

  if (WiFi.status() == WL_CONNECTED) {
    Serial.println("WiFi connected!");
    Serial.println(WiFi.localIP());
  } else {
    Serial.println("WiFi connection timeout.");
    Serial.println("Device will continue offline.");
  }

  drawMainMenu();
}

// -------------------- MAIN MENU --------------------

void handleMainMenu() {
  if (digitalRead(BUTTON_UP_PIN) == LOW && button_up_clicked == 0) {
    button_up_clicked = 1;
    item_selected--;
    if (item_selected < 0) item_selected = NUM_ITEMS - 1;
    tone(BUZZER_PIN, 880, 50);
  }

  if (digitalRead(BUTTON_UP_PIN) == HIGH) {
    button_up_clicked = 0;
  }

  if (digitalRead(BUTTON_DOWN_PIN) == LOW && button_down_clicked == 0) {
    button_down_clicked = 1;
    item_selected++;
    if (item_selected >= NUM_ITEMS) item_selected = 0;
    tone(BUZZER_PIN, 440, 50);
  }

  if (digitalRead(BUTTON_DOWN_PIN) == HIGH) {
    button_down_clicked = 0;
  }

  if (digitalRead(BUTTON_SELECT_PIN) == LOW &&
      button_select_clicked == 0) {

    button_select_clicked = 1;
    tone(BUZZER_PIN, 1200, 150);

    if (item_selected == 0) {
      current_screen = 1;
      game_current_screen = 0;
      game_item_selected = 0;
      resetInputFlags();
      game_button_select_clicked = 1;
    }
    else if (item_selected == 1) {
      current_screen = 2;
      yoga_current_screen = 0;
      yoga_item_selected = 0;
      resetInputFlags();
      yoga_button_select_clicked = 1;
    }
    else if (item_selected == 3) {
      current_screen = 3;
      selected = 0;
      resetInputFlags();
      eg_button_select_clicked = 1;
    }
  }

  if (digitalRead(BUTTON_SELECT_PIN) == HIGH) {
    button_select_clicked = 0;
  }

  drawMainMenu();
}

// -------------------- GAME SUBMENU --------------------

void handleGameMenu() {
  if (digitalRead(BUTTON_UP_PIN) == LOW &&
      game_button_up_clicked == 0) {

    game_button_up_clicked = 1;
    game_item_selected--;
    if (game_item_selected < 0) {
      game_item_selected = GAME_NUM_ITEMS - 1;
    }
    tone(BUZZER_PIN, 880, 50);
  }

  if (digitalRead(BUTTON_UP_PIN) == HIGH) {
    game_button_up_clicked = 0;
  }

  if (digitalRead(BUTTON_DOWN_PIN) == LOW &&
      game_button_down_clicked == 0) {

    game_button_down_clicked = 1;
    game_item_selected++;
    if (game_item_selected >= GAME_NUM_ITEMS) {
      game_item_selected = 0;
    }
    tone(BUZZER_PIN, 440, 50);
  }

  if (digitalRead(BUTTON_DOWN_PIN) == HIGH) {
    game_button_down_clicked = 0;
  }

  // SELECT is intentionally not assigned to a game here because
  // the original file contains no Game 1/2/3 implementation.
  // Add each game's function here when those games are available.
  if (digitalRead(BUTTON_SELECT_PIN) == LOW && game_button_select_clicked == 0) {

      game_button_select_clicked = 1;
      tone(BUZZER_PIN, 1200, 150);

      // Each yoga item gets its own screen.
      if (game_item_selected == 0) {
        game_current_screen = 1;   // Yoga 1
      }
      else if (game_item_selected == 1) {
        game_current_screen = 2;   // Yoga 2
      }
      else {
        game_current_screen = 3;   // Yoga 3
      }
    }


  if (digitalRead(BUTTON_LEFT_PIN) == LOW &&
      button_left_clicked == 0) {

    button_left_clicked = 1;
    current_screen = 0;
    resetInputFlags();
    tone(BUZZER_PIN, 800, 80);
    return;
  }

  if (digitalRead(BUTTON_LEFT_PIN) == HIGH) {
    button_left_clicked = 0;
  }

  drawGameMenu();
}

// -------------------- YOGA SUBMENU --------------------

void handleYogaMenu() {
  if (yoga_current_screen == 0) {

    if (digitalRead(BUTTON_UP_PIN) == LOW &&
        yoga_button_up_clicked == 0) {

      yoga_button_up_clicked = 1;
      yoga_item_selected--;

      if (yoga_item_selected < 0) {
        yoga_item_selected = YOGA_NUM_ITEMS - 1;
      }

      tone(BUZZER_PIN, 880, 50);
    }

    if (digitalRead(BUTTON_UP_PIN) == HIGH) {
      yoga_button_up_clicked = 0;
    }

    if (digitalRead(BUTTON_DOWN_PIN) == LOW &&
        yoga_button_down_clicked == 0) {

      yoga_button_down_clicked = 1;
      yoga_item_selected++;

      if (yoga_item_selected >= YOGA_NUM_ITEMS) {
        yoga_item_selected = 0;
      }

      tone(BUZZER_PIN, 440, 50);
    }

    if (digitalRead(BUTTON_DOWN_PIN) == HIGH) {
      yoga_button_down_clicked = 0;
    }

    if (digitalRead(BUTTON_SELECT_PIN) == LOW &&
        yoga_button_select_clicked == 0) {

      yoga_button_select_clicked = 1;
      tone(BUZZER_PIN, 1200, 150);

      // Each yoga item gets its own screen.
      if (yoga_item_selected == 0) {
        yoga_current_screen = 1;   // Yoga 1
      }
      else if (yoga_item_selected == 1) {
        yoga_current_screen = 2;   // Yoga 2
      }
      else {
        yoga_current_screen = 3;   // Yoga 3
      }

      // Start Yoga 1 animation from the first frame.
      currentFrame = 0;
      lastFrameTime = millis();
    }

    if (digitalRead(BUTTON_SELECT_PIN) == HIGH) {
      yoga_button_select_clicked = 0;
    }

    // LEFT from Yoga menu -> main menu
    if (digitalRead(BUTTON_LEFT_PIN) == LOW &&
        yoga_button_left_clicked == 0) {

      yoga_button_left_clicked = 1;
      current_screen = 0;
      yoga_current_screen = 0;
      resetInputFlags();
      tone(BUZZER_PIN, 800, 80);
      return;
    }

    if (digitalRead(BUTTON_LEFT_PIN) == HIGH) {
      yoga_button_left_clicked = 0;
    }

    drawYogaMenu();
    return;
  }

  // -------------------- YOGA IMAGE SCREEN --------------------
  //
  // No blocking while() is used here.
  // The old code entered a blocking loop while LEFT was held,
  // which made navigation unreliable.
  //
  // A SHORT press of LEFT returns to Yoga menu.
  // A LONG press also returns to Yoga menu, but only once.
  // Neither can accidentally jump directly to the main menu.

  if (digitalRead(BUTTON_LEFT_PIN) == LOW) {

    if (!leftPressActive) {
      leftPressActive = true;
      leftLongPressHandled = false;
      leftPressStart = millis();
    }

    if (!leftLongPressHandled &&
        millis() - leftPressStart >= LONG_PRESS_TIME) {

      leftLongPressHandled = true;
      yoga_current_screen = 0;
      currentFrame = 0;
      lastFrameTime = millis();

      tone(BUZZER_PIN, 800, 100);

      // Wait for release without blocking the display loop.
      // The release is handled below.
    }
  }
  else {
    if (leftPressActive) {

      // If it was released before the long-press threshold,
      // treat it as a normal BACK operation.
      if (!leftLongPressHandled) {
        yoga_current_screen = 0;
        currentFrame = 0;
        lastFrameTime = millis();
        tone(BUZZER_PIN, 800, 80);
      }

      leftPressActive = false;
      leftLongPressHandled = false;
    }
  }

  // Draw Yoga 1/2/3.
  //
  // The original file only supplied an animated frame sequence for
  // Yoga 1. Until separate Yoga 2/3 display logic is added, use the
  // same safe screen behavior instead of showing an uninitialized
  // buffer.
  if (yoga_current_screen == 1) {

    if (millis() - lastFrameTime >= FRAME_INTERVAL) {
      lastFrameTime = millis();
      currentFrame = !currentFrame;
    }

    drawYoga1();
  }
  if (yoga_current_screen == 2) {

    if (millis() - lastFrameTime >= FRAME_INTERVAL) {
      lastFrameTime = millis();
      currentFrame = !currentFrame;
    }

    drawYoga2();
  }
    if (yoga_current_screen == 3) {

    if (millis() - lastFrameTime >= FRAME_INTERVAL) {
      lastFrameTime = millis();
      currentFrame = !currentFrame;
    }

    drawYoga3();
  }
}

// -------------------- EMERGENCY --------------------

void sendTelegramMessage() {
  u8g2.clearBuffer();
  u8g2.setFont(u8g2_font_6x12_tf);
  u8g2.drawStr(0, 20, "Sending...");
  u8g2.sendBuffer();

  Serial.println("Sending Telegram message:");
  Serial.println(messages[selected]);

  bool result = false;

  if (WiFi.status() == WL_CONNECTED) {
    result = bot.sendMessage(
      CHANNEL_ID,
      messages[selected],
      ""
    );
  }

  u8g2.clearBuffer();
  u8g2.setFont(u8g2_font_6x12_tf);

  if (result) {
    Serial.println("Message sent!");
    u8g2.drawStr(0, 20, "Message sent!");
  }
  else {
    Serial.println("Message failed!");
    u8g2.drawStr(0, 20, "Send failed!");
  }

  u8g2.sendBuffer();
  delay(1500);

  drawEmergencyScreen();
}

void handleEmergency() {

  // UP - previous message
  if (digitalRead(BUTTON_UP_PIN) == LOW &&
      eg_button_up_clicked == 0 &&
      millis() - lastButtonTime >= debounceTime) {

    eg_button_up_clicked = 1;
    lastButtonTime = millis();

    selected--;
    if (selected < 0) {
      selected = messageCount - 1;
    }

    tone(BUZZER_PIN, 880, 50);
  }

  if (digitalRead(BUTTON_UP_PIN) == HIGH) {
    eg_button_up_clicked = 0;
  }

  // DOWN - next message
  if (digitalRead(BUTTON_DOWN_PIN) == LOW &&
      eg_button_down_clicked == 0 &&
      millis() - lastButtonTime >= debounceTime) {

    eg_button_down_clicked = 1;
    lastButtonTime = millis();

    selected++;
    if (selected >= messageCount) {
      selected = 0;
    }

    tone(BUZZER_PIN, 440, 50);
  }

  if (digitalRead(BUTTON_DOWN_PIN) == HIGH) {
    eg_button_down_clicked = 0;
  }

  // SELECT - send exactly once per press
  if (digitalRead(BUTTON_SELECT_PIN) == LOW &&
      eg_button_select_clicked == 0 &&
      millis() - lastButtonTime >= debounceTime) {

    eg_button_select_clicked = 1;
    lastButtonTime = millis();

    tone(BUZZER_PIN, 1200, 150);
    sendTelegramMessage();
  }

  if (digitalRead(BUTTON_SELECT_PIN) == HIGH) {
    eg_button_select_clicked = 0;
  }

  // LEFT - return to main menu
  if (digitalRead(BUTTON_LEFT_PIN) == LOW &&
      button_left_clicked == 0) {

    button_left_clicked = 1;
    current_screen = 0;
    yoga_current_screen = 0;
    resetInputFlags();

    tone(BUZZER_PIN, 800, 80);
    return;
  }

  if (digitalRead(BUTTON_LEFT_PIN) == HIGH) {
    button_left_clicked = 0;
  }

  drawEmergencyScreen();
}

// -------------------- LOOP --------------------

void loop() {

  if (current_screen == 0) {
    handleMainMenu();
  }
  else if (current_screen == 1) {
    handleGameMenu();
  }
  else if (current_screen == 2) {
    handleYogaMenu();
  }
  else if (current_screen == 3) {
    handleEmergency();
  }
}
