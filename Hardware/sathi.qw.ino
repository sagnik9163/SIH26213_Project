#include <Arduino.h>
#include <WiFi.h>
#include <WiFiClientSecure.h>
#include <UniversalTelegramBot.h>
#include <ArduinoJson.h>
#include <U8g2lib.h>
#include <Wire.h>
#include <freertos/FreeRTOS.h>
#include <freertos/task.h>
#include <freertos/semphr.h>

struct Button;

// WiFi
const char* WIFI_SSID = "OnePlus Nord CE 3 Lite 5G";
const char* WIFI_PASSWORD = "w5cuke7u";

U8G2_SH1106_128X64_NONAME_F_HW_I2C u8g2(U8G2_R0,U8X8_PIN_NONE);

// Telegram
#define BOT_TOKEN "8534452035:AAGdhsQ4PJ7C8yA4hnIOFnbkCN81ooIzFTo"
const char* CHANNEL_ID = "-1004398180069";

WiFiClientSecure client;
UniversalTelegramBot bot(BOT_TOKEN, client);

// 'Emergency_icon'
const unsigned char bitmap_Emergency_icon [] PROGMEM = {
	0x00, 0x00, 0x00, 0x00, 0xc0, 0x03, 0xe0, 0x07, 0xf0, 0x0f, 0x70, 0x0e, 0x70, 0x0e, 0x10, 0x08, 
	0x10, 0x08, 0x70, 0x0e, 0x70, 0x0e, 0xf0, 0x0f, 0x00, 0x00, 0xfc, 0x3f, 0xfc, 0x3f, 0x00, 0x00
};
// 'game_icon'
const unsigned char bitmap_game_icon [] PROGMEM = {
	0x00, 0x00, 0x00, 0x00, 0xf0, 0x0f, 0x08, 0x10, 0x24, 0x24, 0x72, 0x4a, 0x22, 0x44, 0xc2, 0x43, 
	0x22, 0x44, 0x12, 0x48, 0x12, 0x48, 0x12, 0x48, 0x0c, 0x30, 0x00, 0x00, 0x00, 0x00, 0x00, 0x00
};
// 'reminder_logo'
const unsigned char bitmap_reminder_logo [] PROGMEM = {
	0x00, 0x00, 0x00, 0x00, 0x80, 0x01, 0xc0, 0x03, 0xe0, 0x07, 0xe0, 0x07, 0xe0, 0x07, 0xf0, 0x0f, 
	0xf8, 0x1f, 0xf8, 0x1f, 0xf0, 0x0f, 0x00, 0x00, 0x40, 0x02, 0x80, 0x01, 0x00, 0x00, 0x00, 0x00
};
// 'setting_logo'
const unsigned char bitmap_setting_logo [] PROGMEM = {
	0x00, 0x00, 0x00, 0x00, 0x98, 0x0f, 0xd8, 0x1f, 0xd8, 0x18, 0xd8, 0x18, 0x18, 0x18, 0x18, 0x18, 
	0x18, 0x1c, 0x18, 0x0e, 0x18, 0x07, 0x00, 0x00, 0x98, 0x01, 0x98, 0x01, 0x00, 0x00, 0x00, 0x00
};
// 'yoga_icon'
const unsigned char bitmap_yoga_icon [] PROGMEM = {
	0x00, 0x00, 0x40, 0x02, 0x20, 0x04, 0x90, 0x09, 0xa0, 0x05, 0x40, 0x02, 0x00, 0x01, 0x00, 0x01, 
	0x00, 0x01, 0x00, 0x01, 0x80, 0x02, 0x80, 0x04, 0x80, 0x02, 0x80, 0x00, 0x80, 0x00, 0x00, 0x00
};

const unsigned char* bitmap_icons[5] = {
	bitmap_game_icon,
  bitmap_yoga_icon,
  bitmap_reminder_logo,
  bitmap_Emergency_icon,
	bitmap_setting_logo
};

// 'scrollbar_background', 8x64px
const unsigned char bitmap_scrollbar_background [] PROGMEM = {
  0x00, 0x40, 0x00, 0x40, 0x00, 0x40, 0x00, 0x40, 0x00, 0x40, 0x00, 0x40, 
  0x00, 0x40, 0x00, 0x40, 0x00, 0x40, 0x00, 0x40, 0x00, 0x40, 0x00, 0x40, 
  0x00, 0x40, 0x00, 0x40, 0x00, 0x40, 0x00, 0x40, 0x00, 0x40, 0x00, 0x40, 
  0x00, 0x40, 0x00, 0x40, 0x00, 0x40, 0x00, 0x40, 0x00, 0x40, 0x00, 0x40, 
  0x00, 0x40, 0x00, 0x40, 0x00, 0x40, 0x00, 0x40, 0x00, 0x40, 0x00, 0x40, 
  0x00, 0x40, 0x00, 0x00, };


// 'item_sel_outline', 128x21px
const unsigned char bitmap_item_sel_outline [] PROGMEM = {
  0xF8, 0xFF, 0xFF, 0xFF, 0xFF, 0xFF, 0xFF, 0xFF, 0xFF, 0xFF, 0xFF, 0xFF, 
  0xFF, 0xFF, 0xFF, 0x03, 0x04, 0x00, 0x00, 0x00, 0x00, 0x00, 0x00, 0x00, 
  0x00, 0x00, 0x00, 0x00, 0x00, 0x00, 0x00, 0x04, 0x02, 0x00, 0x00, 0x00, 
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  0xFF, 0xFF, 0xFF, 0xFF, 0xFF, 0xFF, 0xFF, 0xFF, 0xFF, 0xFF, 0xFF, 0x03, 
  };

const int NUM_ITEMS = 5; // number of items in the list and also the number of screenshots and screenshots with QR codes (other screens)
const int MAX_ITEM_LENGTH = 20; // maximum characters for the item name

char menu_items [NUM_ITEMS] [MAX_ITEM_LENGTH] = {  // array with item names
  { "Game" }, 
  { "Exercise" }, 
  { "Reminder" }, 
  { "Emergency" }, 
  { "Setting" }
 };


 //YOGA BITMAPS//
 // 'YOGA3L1', 64x64px
const unsigned char bitmap_YOGA3L1 [] PROGMEM = {
	0x00, 0x00, 0x00, 0x00, 0x00, 0x00, 0x00, 0x00, 0x00, 0x00, 0x00, 0x00, 0x00, 0x00, 0x00, 0x00, 
	0x00, 0x00, 0x00, 0x00, 0x00, 0x00, 0x00, 0x00, 0x00, 0x00, 0x00, 0x00, 0x00, 0x00, 0x00, 0x00, 
	0x00, 0x00, 0x00, 0x00, 0x00, 0x00, 0x00, 0x00, 0x00, 0x00, 0x00, 0x00, 0x00, 0x00, 0x00, 0x00, 
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	0x00, 0x00, 0x00, 0x00, 0x00, 0x00, 0x00, 0x00, 0x00, 0x00, 0x00, 0x00, 0x00, 0x00, 0x00, 0x00
};
// 'YOGA2L1', 64x64px
const unsigned char bitmap_YOGA2L1 [] PROGMEM = {
	0x00, 0x00, 0x00, 0x00, 0x00, 0x00, 0x00, 0x00, 0x00, 0x00, 0x00, 0x00, 0x00, 0x00, 0x00, 0x00, 
	0x00, 0x00, 0x00, 0x00, 0x00, 0x00, 0x00, 0x00, 0x00, 0x00, 0x00, 0x00, 0x00, 0x00, 0x00, 0x00, 
	0x00, 0x00, 0x00, 0x00, 0x00, 0x00, 0x00, 0x00, 0x00, 0x00, 0x00, 0x00, 0x00, 0x00, 0x00, 0x00, 
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	0x00, 0x00, 0x00, 0x00, 0x00, 0x00, 0x00, 0x00, 0x00, 0x00, 0x00, 0x00, 0x00, 0x00, 0x00, 0x00
};
// 'YOGA3R2', 64x64px
const unsigned char bitmap_YOGA3R2 [] PROGMEM = {
	0x00, 0x00, 0x00, 0x00, 0x00, 0x00, 0x00, 0x00, 0x00, 0x00, 0x00, 0x00, 0x00, 0x00, 0x00, 0x00, 
	0x00, 0x00, 0x00, 0x00, 0x00, 0x00, 0x00, 0x00, 0x00, 0x00, 0x00, 0x00, 0x00, 0x00, 0x00, 0x00, 
	0x00, 0x00, 0x00, 0x00, 0x00, 0x00, 0x00, 0x00, 0x00, 0x00, 0x00, 0x00, 0x00, 0x00, 0x00, 0x00, 
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	0x00, 0x00, 0x00, 0x00, 0x00, 0x00, 0x00, 0x00, 0x00, 0x00, 0x00, 0x00, 0x00, 0x00, 0x00, 0x00
};
// 'YOGA2R2', 64x64px
const unsigned char bitmap_YOGA2R2 [] PROGMEM = {
	0x00, 0x00, 0x00, 0x00, 0x00, 0x00, 0x00, 0x00, 0x00, 0x00, 0x00, 0x00, 0x00, 0x00, 0x00, 0x00, 
	0x00, 0x00, 0x00, 0x00, 0x00, 0x00, 0x00, 0x00, 0x00, 0x00, 0x00, 0x00, 0x00, 0x00, 0x00, 0x00, 
	0x00, 0x00, 0x00, 0x00, 0x00, 0x00, 0x00, 0x00, 0x00, 0x00, 0x00, 0x00, 0x00, 0x00, 0x00, 0x00, 
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	0x00, 0x00, 0x00, 0x00, 0x00, 0x00, 0x00, 0x00, 0x00, 0x00, 0x00, 0x00, 0x00, 0x00, 0x00, 0x00
};
// 'YOGA2L2', 64x64px
const unsigned char bitmap_YOGA2L2 [] PROGMEM = {
	0x00, 0x00, 0x00, 0x00, 0x00, 0x00, 0x00, 0x00, 0x00, 0x00, 0x00, 0x00, 0xc0, 0x03, 0x00, 0x00, 
	0x00, 0x00, 0x00, 0x00, 0xc0, 0x07, 0x00, 0x00, 0x00, 0x00, 0x06, 0x00, 0xe0, 0x07, 0x00, 0x00, 
	0x00, 0x00, 0x0f, 0x00, 0xe0, 0x07, 0x00, 0x00, 0x00, 0x80, 0x1f, 0x00, 0xe0, 0x07, 0x00, 0x00, 
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	0x00, 0x00, 0x00, 0xfe, 0xff, 0x03, 0x00, 0x00, 0x00, 0x00, 0x00, 0xfe, 0xff, 0x03, 0x00, 0x00
};
// 'YOGA1R2', 64x64px
const unsigned char bitmap_YOGA1R2 [] PROGMEM = {
	0x00, 0x00, 0x00, 0x00, 0x00, 0x00, 0x00, 0x00, 0x00, 0x00, 0x00, 0x00, 0x00, 0x00, 0x00, 0x00, 
	0x00, 0x00, 0x00, 0x00, 0x00, 0x00, 0x00, 0x00, 0x00, 0x00, 0x00, 0x00, 0x0f, 0x3c, 0x00, 0x00, 
	0x00, 0x00, 0x00, 0x80, 0xbf, 0x7f, 0x00, 0x00, 0x00, 0x00, 0x00, 0xc0, 0xff, 0xff, 0x07, 0x00, 
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	0x00, 0x00, 0x00, 0x00, 0xf8, 0xff, 0xff, 0x01, 0x00, 0x00, 0x00, 0x00, 0xf8, 0xff, 0xff, 0x01
};
// 'YOGA3L2', 64x64px
const unsigned char bitmap_YOGA3L2 [] PROGMEM = {
	0x00, 0x00, 0x00, 0x00, 0x00, 0x00, 0x00, 0x00, 0x00, 0x00, 0x00, 0x00, 0x00, 0x00, 0x00, 0x00, 
	0x00, 0x00, 0x00, 0x00, 0x00, 0x00, 0x00, 0x00, 0x00, 0x00, 0x00, 0x00, 0x00, 0x00, 0x00, 0x00, 
	0x00, 0x00, 0x00, 0x30, 0x00, 0x00, 0x00, 0x00, 0x00, 0x00, 0x00, 0x70, 0x00, 0x00, 0x00, 0x00, 
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	0x00, 0x00, 0x00, 0x00, 0x00, 0x00, 0x00, 0x00, 0x00, 0x00, 0x00, 0x00, 0x00, 0x00, 0x00, 0x00
};
// 'YOGA1R1', 64x64px
const unsigned char bitmap_YOGA1R1 [] PROGMEM = {
	0x00, 0x00, 0x00, 0x00, 0x00, 0x00, 0x00, 0x00, 0x00, 0x00, 0x00, 0x00, 0x00, 0xc0, 0x01, 0x00, 
	0x00, 0x00, 0x00, 0x00, 0x00, 0xe0, 0x03, 0x00, 0x00, 0x00, 0x00, 0x00, 0x00, 0xe0, 0x03, 0x00, 
	0x00, 0x00, 0x00, 0x00, 0x00, 0xe0, 0x03, 0x00, 0x00, 0x00, 0x00, 0x00, 0x00, 0xe0, 0x03, 0x00, 
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	0x00, 0x00, 0x00, 0xfc, 0xff, 0x7f, 0x00, 0x00, 0x00, 0x00, 0x00, 0xfc, 0xff, 0x7f, 0x00, 0x00
};
// 'YOGA1L1', 64x64px
const unsigned char bitmap_YOGA1L1 [] PROGMEM = {
	0x00, 0x00, 0x00, 0x00, 0x00, 0x00, 0x00, 0x00, 0x00, 0x00, 0x00, 0x00, 0x00, 0x00, 0x00, 0x00, 
	0x00, 0x00, 0x00, 0x00, 0x00, 0x00, 0x00, 0x00, 0x00, 0x00, 0x3c, 0xf0, 0x00, 0x00, 0x00, 0x00, 
	0x00, 0x00, 0xfe, 0xfd, 0x01, 0x00, 0x00, 0x00, 0x00, 0xe0, 0xff, 0xff, 0x03, 0x00, 0x00, 0x00, 
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	0x80, 0xff, 0xff, 0x1f, 0x00, 0x00, 0x00, 0x00, 0x80, 0xff, 0xff, 0x1f, 0x00, 0x00, 0x00, 0x00
};
// 'YOGA3R1', 64x64px
const unsigned char bitmap_YOGA3R1 [] PROGMEM = {
	0x00, 0x00, 0x00, 0x00, 0x00, 0x00, 0x00, 0x00, 0x00, 0x00, 0x00, 0x00, 0x00, 0x00, 0x00, 0x00, 
	0x00, 0x00, 0x00, 0x00, 0x00, 0x00, 0x00, 0x00, 0x00, 0x00, 0x00, 0x00, 0x00, 0x00, 0x00, 0x00, 
	0x00, 0x00, 0x00, 0x00, 0x0c, 0x00, 0x00, 0x00, 0x00, 0x00, 0x00, 0x00, 0x0e, 0x00, 0x00, 0x00, 
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	0x00, 0x00, 0x00, 0x00, 0x00, 0x00, 0x00, 0x00, 0x00, 0x00, 0x00, 0x00, 0x00, 0x00, 0x00, 0x00
};
// 'YOGA2R1', 64x64px
const unsigned char bitmap_YOGA2R1 [] PROGMEM = {
	0x00, 0x00, 0x00, 0x00, 0x00, 0x00, 0x00, 0x00, 0x00, 0x00, 0xe0, 0x03, 0x00, 0x00, 0x00, 0x00, 
	0x00, 0x00, 0xe0, 0x03, 0x00, 0x00, 0x00, 0x00, 0x00, 0x00, 0xe0, 0x07, 0x00, 0x60, 0x00, 0x00, 
	0x00, 0x00, 0xe0, 0x07, 0x00, 0xf0, 0x00, 0x00, 0x00, 0x00, 0xe0, 0x07, 0x00, 0xf0, 0x01, 0x00, 
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	0x00, 0x00, 0xc0, 0xff, 0x7f, 0x00, 0x00, 0x00, 0x00, 0x00, 0xc0, 0xff, 0x7f, 0x00, 0x00, 0x00
};
// 'YOGA1L2', 64x64px
const unsigned char bitmap_YOGA1L2 [] PROGMEM = {
	0x00, 0x00, 0x00, 0x00, 0x00, 0x00, 0x00, 0x00, 0x00, 0x80, 0x03, 0x00, 0x00, 0x00, 0x00, 0x00, 
	0x00, 0xc0, 0x07, 0x00, 0x00, 0x00, 0x00, 0x00, 0x00, 0xc0, 0x07, 0x00, 0x00, 0x00, 0x00, 0x00, 
	0x00, 0xc0, 0x07, 0x00, 0x00, 0x00, 0x00, 0x00, 0x00, 0xc0, 0x07, 0x00, 0x00, 0x00, 0x00, 0x00, 
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	0x00, 0x00, 0xfe, 0xff, 0x3f, 0x00, 0x00, 0x00, 0x00, 0x00, 0xfe, 0xff, 0x3f, 0x00, 0x00, 0x00
};

// Array of all bitmaps for convenience. (Total bytes used to store images in PROGMEM = 6336)
const int YOGA_LEN = 12;
const unsigned char* YOGA[YOGA_LEN] = {
	bitmap_YOGA1L1,
  bitmap_YOGA1R1,
	bitmap_YOGA1L2,
	bitmap_YOGA1R2,
	bitmap_YOGA2L1,
  bitmap_YOGA2R1,
	bitmap_YOGA2L2,
	bitmap_YOGA2R2,
	bitmap_YOGA3L1,
  bitmap_YOGA3L2,
	bitmap_YOGA3R1,
  bitmap_YOGA3R2
};

const unsigned char icon_smiley[] PROGMEM = {
  0xe0, 0x07, 0x18, 0x18, 0x04, 0x20, 0x02, 0x40, 0xc2, 0x43, 0x02, 0x40, 0x02, 0x40, 0x22, 0x44, 
  0x22, 0x44, 0x12, 0x48, 0x0a, 0x50, 0x04, 0x20, 0x18, 0x18, 0xe0, 0x07, 0x00, 0x00, 0x00, 0x00
};
// 2. Heart
const unsigned char icon_heart[] PROGMEM = {
  0x00, 0x00, 0x38, 0x1c, 0x7c, 0x3e, 0xfe, 0x7f, 0xfe, 0x7f, 0xfe, 0x7f, 0xfc, 0x3f, 0xf8, 0x1f, 
  0xf0, 0x0f, 0xe0, 0x07, 0xc0, 0x03, 0x80, 0x01, 0x00, 0x00, 0x00, 0x00, 0x00, 0x00, 0x00, 0x00
};
// 3. Star
const unsigned char icon_star[] PROGMEM = {
  0x80, 0x01, 0x80, 0x01, 0x80, 0x01, 0xc0, 0x03, 0xcc, 0x33, 0xfe, 0x7f, 0xfe, 0x7f, 0xfc, 0x3f, 
  0xf8, 0x1f, 0xf0, 0x0f, 0xe0, 0x07, 0xe0, 0x07, 0xc0, 0x03, 0x80, 0x01, 0x00, 0x00, 0x00, 0x00
};
// 4. House
const unsigned char icon_house[] PROGMEM = {
  0x80, 0x01, 0xc0, 0x03, 0xe0, 0x07, 0xf0, 0x0f, 0xf8, 0x1f, 0xfc, 0x3f, 0xfe, 0x7f, 0xff, 0xff, 
  0x02, 0x40, 0x02, 0x40, 0x02, 0x40, 0xfa, 0x5f, 0xfa, 0x5f, 0xfa, 0x5f, 0xfe, 0x7f, 0x00, 0x00
};
// 5. Music Note
const unsigned char icon_music[] PROGMEM = {
  0x00, 0x03, 0x00, 0x05, 0x00, 0x09, 0x00, 0x11, 0x00, 0x21, 0x00, 0x41, 0x00, 0x41, 0x00, 0x41, 
  0x00, 0x41, 0x00, 0x41, 0x38, 0x41, 0x7c, 0x01, 0x7c, 0x00, 0x38, 0x00, 0x00, 0x00, 0x00, 0x00
};
// 6. Coffee Cup
const unsigned char icon_cup[] PROGMEM = {
  0x00, 0x00, 0xfc, 0x3f, 0x04, 0x20, 0x04, 0x20, 0x04, 0x22, 0x04, 0x22, 0x04, 0x22, 0x04, 0x22, 
  0x04, 0x21, 0x08, 0x11, 0x10, 0x08, 0x20, 0x04, 0xc0, 0x03, 0x00, 0x00, 0x00, 0x00, 0x00, 0x00
};

// Create an array that holds all our icons so we can easily select them by number
const unsigned char* iconSet[] = {icon_smiley, icon_heart, icon_star, icon_house, icon_music, icon_cup};
const int iconSetSize = 6;

// -------------------- BUTTON / NAVIGATION --------------------

#define BUTTON_UP_PIN     18
#define BUTTON_SELECT_PIN 19
#define BUTTON_DOWN_PIN   23
#define BUTTON_LEFT_PIN   26
#define BUTTON_RIGHT_PIN  27
#define BUZZER_PIN        25
#define BUTTON_BACK_PIN   33
// Unconnected analog pin for random seed

#define RANDOM_SEED_PIN 34 

// Main menu
int button_up_clicked = 0;
int button_select_clicked = 0;
int button_down_clicked = 0;
int button_left_clicked = 0;

int item_selected = 0;
int item_sel_previous = 0;
int item_sel_next = 0;

// 0 = main menu, 1 = game submenu, 2 = yoga submenu, 3 = emergency
int current_screen = 0;

// Game submenu
const int GAME_NUM_ITEMS = 3;
const int GAME_MAX_ITEM_LENGTH = 20;

char game_menu_items[GAME_NUM_ITEMS][GAME_MAX_ITEM_LENGTH] = {
  "Recall",
  "Quick Math",
  "Spot Diff"
};

int game_button_up_clicked = 0;
int game_button_select_clicked = 0;
int game_button_down_clicked = 0;
int game_item_selected = 0;
int game_item_sel_previous = 0;
int game_item_sel_next = 0;
int game_button_left_clicked = 0;

// 0 = game menu
int game_current_screen = 0;

// Yoga submenu
const int YOGA_NUM_ITEMS = 3;
const int YOGA_MAX_ITEM_LENGTH = 20;

char yoga_menu_items[YOGA_NUM_ITEMS][YOGA_MAX_ITEM_LENGTH] = {
  "Yoga 1",
  "Yoga 2",
  "Yoga 3"
};

int yoga_button_up_clicked = 0;
int yoga_button_select_clicked = 0;
int yoga_button_down_clicked = 0;
int yoga_button_left_clicked = 0;

int yoga_item_selected = 0;
int yoga_item_sel_previous = 0;
int yoga_item_sel_next = 0;

// 0 = yoga menu, 1 = yoga 1 animation, 2 = yoga 2,
// 3 = yoga 3
int yoga_current_screen = 0;

// Yoga animation
unsigned long lastFrameTime = 0;
const unsigned long FRAME_INTERVAL = 1000;
bool currentFrame = false;

// -------------------- REMINDER MENU --------------------

int reminder_menu_selected = 0;
int reminder_menu_scroll = 0;

int reminder_button_up_clicked = 0;
int reminder_button_down_clicked = 0;
int reminder_button_select_clicked = 0;
int reminder_button_left_clicked = 0;

// -------------------- EMERGENCY --------------------

int eg_button_down_clicked = 0;
int eg_button_up_clicked = 0;
int eg_button_select_clicked = 0;

int selected = 0;

String messages[] = {
  "/sos Medical Emergency - Need help now!",
  "/sos Fall Detected - Please check on me",
  "/sos Need Assistance - Not urgent",
  "/sos I'm OK - Just checking in"
};

const int messageCount = 4;

// Emergency button debounce
unsigned long lastButtonTime = 0;
const unsigned long debounceTime = 100;

// -------------------- LEFT/BACK LONG PRESS --------------------

// Non-blocking long-press handling.
// A long press is handled only once, after the button has been held
// for LONG_PRESS_TIME milliseconds.
bool leftPressActive = false;
bool leftLongPressHandled = false;
unsigned long leftPressStart = 0;
const unsigned long LONG_PRESS_TIME = 1000;

// -------------------- ASYNC TELEGRAM SENDING --------------------
// Emergency messages are also sent from a background task. This prevents
// HTTPS from freezing the UI while a message is being sent.
TaskHandle_t telegramTaskHandle = NULL;
SemaphoreHandle_t telegramMutex = NULL;
volatile bool telegramSendPending = false;
volatile bool telegramSendDone = false;
volatile bool telegramSendResult = false;
volatile int telegramMessageIndex = 0;
unsigned long telegramResultTime = 0;
bool telegramSending = false;

// -------------------- REMINDER BOT (NEW) --------------------
//
// A second, independent Telegram bot + chat, dedicated to reminders.
// Send it a message in the form:   /remind HH:MM your text here
// and it will reply with a confirmation. When the device clock hits
// that HH:MM, the reminder pops up on screen (over whatever screen
// is currently showing) and the buzzer rings for 5 seconds.
//
// Fill these in with your second bot's token and the chat/channel ID
// you want it to listen to (same way CHANNEL_ID was obtained above:
// message the bot, then call reminderBot.getUpdates() once and read
// the chat_id from Serial, or use @userinfobot / @RawDataBot).

const char* REMINDER_BOT_TOKEN = "8720491965:AAGHPhu5pmooJj2_cB4Lic2TfE4mNDHBb5Y";
const char* REMINDER_CHAT_ID   = "-1004468259020";

WiFiClientSecure reminderClient;
UniversalTelegramBot reminderBot(REMINDER_BOT_TOKEN, reminderClient);

#define MAX_REMINDERS 10

struct Reminder {
  int hour;
  int minute;
  String text;
  bool active;    // true = waiting to fire
  bool used;      // true = reminder exists and can be shown in menu
};

Reminder reminders[MAX_REMINDERS];
int reminderCount = 0;

// Telegram polling runs in its own FreeRTOS task so HTTPS traffic can
// never block the button/OLED loop.
TaskHandle_t reminderTaskHandle = NULL;
SemaphoreHandle_t reminderMutex = NULL;
const unsigned long REMINDER_POLL_INTERVAL = 4000; // ms

// How often we check the clock against stored reminders.
unsigned long lastTimeCheckTime = 0;
const unsigned long TIME_CHECK_INTERVAL = 1000; // ms

// Reminder popup / buzzer state
bool reminderPopupActive = false;
unsigned long reminderPopupStart = 0;
const unsigned long REMINDER_POPUP_DURATION = 5000; // ms - popup + buzzer length
String reminderPopupText = "";

// Sets up NTP so the ESP32 knows the actual time-of-day, which is
// required to compare against HH:MM reminders. Call once from
// setup(), after WiFi has connected.
void setupReminderSystem() {
  reminderClient.setInsecure();

  // GMT offset in seconds, then daylight-saving offset in seconds.
  // 19800 = +5:30 (India). Change this if the device is used elsewhere.
  configTime(19800, 0, "pool.ntp.org", "time.nist.gov");
}

// Adds a reminder to the first free slot. Silently drops it if the
// list is full (MAX_REMINDERS reached).
void addReminder(int hour, int minute, String text) {

  if (reminderMutex) {
    xSemaphoreTake(reminderMutex, portMAX_DELAY);
  }

  int slot = -1;

  // Find an unused slot
  for (int i = 0; i < MAX_REMINDERS; i++) {

    if (!reminders[i].used) {
      slot = i;
      break;
    }
  }

  if (slot != -1) {

    reminders[slot].hour = hour;
    reminders[slot].minute = minute;
    reminders[slot].text = text;

    reminders[slot].active = true;
    reminders[slot].used = true;

    if (slot >= reminderCount) {
      reminderCount = slot + 1;
    }

    Serial.println("Reminder added:");
    Serial.print(hour);
    Serial.print(":");
    Serial.print(minute);
    Serial.print(" - ");
    Serial.println(text);

  } else {

    Serial.println("Reminder list is full!");

  }

  if (reminderMutex) {
    xSemaphoreGive(reminderMutex);
  }
}

//To count reminder
int getReminderMenuCount() {

  int count = 0;

  if (reminderMutex) {
    xSemaphoreTake(reminderMutex, portMAX_DELAY);
  }

  for (int i = 0; i < MAX_REMINDERS; i++) {

    if (reminders[i].used) {
      count++;
    }
  }

  if (reminderMutex) {
    xSemaphoreGive(reminderMutex);
  }

  return count;
}

//To get actual reminder index
int getReminderArrayIndex(int menuIndex) {

  int count = 0;
  int result = -1;

  if (reminderMutex) {
    xSemaphoreTake(reminderMutex, portMAX_DELAY);
  }

  for (int i = 0; i < MAX_REMINDERS; i++) {

    if (reminders[i].used) {

      if (count == menuIndex) {
        result = i;
        break;
      }

      count++;
    }
  }

  if (reminderMutex) {
    xSemaphoreGive(reminderMutex);
  }

  return result;
}

// Parses "/remind HH:MM some text" into hour, minute, text.
// Returns false (and leaves the outputs untouched) on any bad format.
bool parseReminderCommand(String msg, int &hour, int &minute, String &text) {
  msg.trim();
  if (!msg.startsWith("/remind ")) return false;

  String rest = msg.substring(8); // strip "/remind "
  int colonIdx = rest.indexOf(':');
  int spaceIdx = rest.indexOf(' ');
  if (colonIdx == -1 || spaceIdx == -1 || spaceIdx < colonIdx) return false;

  String hh = rest.substring(0, colonIdx);
  String mm = rest.substring(colonIdx + 1, spaceIdx);
  String remText = rest.substring(spaceIdx + 1);
  remText.trim();

  int h = hh.toInt();
  int m = mm.toInt();

  if (h < 0 || h > 23 || m < 0 || m > 59) return false;
  if (remText.length() == 0) return false;

  hour = h;
  minute = m;
  text = remText;
  return true;
}

// Poll the reminder bot. This function is called only from the background
// FreeRTOS task, so any HTTPS delay cannot block the UI.
void pollReminderBot() {
  if (WiFi.status() != WL_CONNECTED) return;

  int numNewMessages = reminderBot.getUpdates(reminderBot.last_message_received + 1);

  for (int i = 0; i < numNewMessages; i++) {
    String chatId = reminderBot.messages[i].chat_id;
    String text   = reminderBot.messages[i].text;

    int hour, minute;
    String remText;

    if (parseReminderCommand(text, hour, minute, remText)) {
      addReminder(hour, minute, remText);

      char confirmMsg[80];
      snprintf(confirmMsg, sizeof(confirmMsg), "Reminder set for %02d:%02d", hour, minute);
      reminderBot.sendMessage(chatId, confirmMsg, "");
    } else {
      reminderBot.sendMessage(chatId, "Format: /remind HH:MM your text", "");
    }
  }
}

// Background reminder task. It may block on HTTPS, but only this task
// is blocked; the main UI loop remains responsive.
void reminderTask(void *parameter) {
  for (;;) {
    if (WiFi.status() == WL_CONNECTED) {
      pollReminderBot();
    }
    vTaskDelay(pdMS_TO_TICKS(REMINDER_POLL_INTERVAL));
  }
}

// Background emergency Telegram task.
void telegramTask(void *parameter) {
  for (;;) {
    bool doSend = false;
    int msgIndex = 0;

    if (telegramMutex) xSemaphoreTake(telegramMutex, portMAX_DELAY);
    if (telegramSendPending) {
      telegramSendPending = false;
      doSend = true;
      msgIndex = telegramMessageIndex;
    }
    if (telegramMutex) xSemaphoreGive(telegramMutex);

    if (doSend) {
      bool result = false;
      if (WiFi.status() == WL_CONNECTED) {
        result = bot.sendMessage(CHANNEL_ID, messages[msgIndex], "");
      }

      if (telegramMutex) xSemaphoreTake(telegramMutex, portMAX_DELAY);
      telegramSendResult = result;
      telegramSendDone = true;
      if (telegramMutex) xSemaphoreGive(telegramMutex);
    }

    vTaskDelay(pdMS_TO_TICKS(20));
  }
}

// Checks the current time against all active reminders. When one
// matches, it fires the popup + 5s buzzer and deactivates itself
// (one-shot). Requires setupReminderSystem() to have run and NTP to
// have synced at least once; until then time(nullptr) reads as 0 and
// this simply does nothing.
void checkReminders() {
  time_t now = time(nullptr);
  if (now < 1000) return;

  struct tm *t = localtime(&now);
  if (t == nullptr) return;

  int curHour = t->tm_hour;
  int curMinute = t->tm_min;
  String firedText = "";

  if (reminderMutex) xSemaphoreTake(reminderMutex, portMAX_DELAY);

  for (int i = 0; i < MAX_REMINDERS; i++) {

  if (!reminders[i].used) continue;
  if (!reminders[i].active) continue;

    if (reminders[i].hour == curHour && reminders[i].minute == curMinute) {
      reminders[i].active = false;
      firedText = reminders[i].text;
      break;
    }
  }

  if (reminderMutex) xSemaphoreGive(reminderMutex);

  if (firedText.length() > 0) {
    reminderPopupActive = true;
    reminderPopupStart = millis();
    reminderPopupText = firedText;
    tone(BUZZER_PIN, 1500, REMINDER_POPUP_DURATION);
  }
}

// Draws the reminder popup. Deliberately mirrors the look of
// drawEmergencyScreen() so it feels consistent with the rest of the UI.
void drawReminderPopup() {
  u8g2.clearBuffer();

  u8g2.setFont(u8g2_font_6x10_tr);
  u8g2.drawBox(0, 0, 128, 14);
  u8g2.setDrawColor(0);
  u8g2.drawStr(34, 11, "REMINDER");
  u8g2.setDrawColor(1);

  u8g2.drawRFrame(2, 17, 124, 40, 3);

  // Simple word-wrap so longer reminder text is still readable.
  const int maxCharsPerLine = 20;
  String txt = reminderPopupText;
  int lineY = 30;
  while (txt.length() > 0 && lineY < 55) {
    int cut = min((int)txt.length(), maxCharsPerLine);
    String line = txt.substring(0, cut);
    u8g2.drawStr(8, lineY, line.c_str());
    txt = txt.substring(cut);
    lineY += 12;
  }

  u8g2.sendBuffer();
}

// -------------------- HELPERS --------------------

void resetInputFlags() {
  button_up_clicked = 0;
  button_select_clicked = 0;
  button_down_clicked = 0;
  button_left_clicked = 0;

  game_button_up_clicked = 0;
  game_button_select_clicked = 0;
  game_button_down_clicked = 0;

  yoga_button_up_clicked = 0;
  yoga_button_select_clicked = 0;
  yoga_button_down_clicked = 0;
  yoga_button_left_clicked = 0;

  eg_button_up_clicked = 0;
  eg_button_down_clicked = 0;
  eg_button_select_clicked = 0;
}

//game 
int maxcurrentLevel;
int maxcurrentLevel1;
int maxcurrentLevel2;
void drawMainMenu() {
  item_sel_previous = item_selected - 1;
  if (item_sel_previous < 0) item_sel_previous = NUM_ITEMS - 1;

  item_sel_next = item_selected + 1;
  if (item_sel_next >= NUM_ITEMS) item_sel_next = 0;

  u8g2.clearBuffer();

  u8g2.drawXBMP(0, 22, 128, 21, bitmap_item_sel_outline);

  u8g2.setFont(u8g_font_7x14);
  u8g2.drawStr(25, 15, menu_items[item_sel_previous]);
  u8g2.drawXBMP(4, 2, 16, 16, bitmap_icons[item_sel_previous]);

  u8g2.setFont(u8g_font_7x14B);
  u8g2.drawStr(25, 37, menu_items[item_selected]);
  u8g2.drawXBMP(4, 24, 16, 16, bitmap_icons[item_selected]);

  u8g2.setFont(u8g_font_7x14);
  u8g2.drawStr(25, 57, menu_items[item_sel_next]);
  u8g2.drawXBMP(4, 46, 16, 16, bitmap_icons[item_sel_next]);

  u8g2.drawXBMP(120, 0, 8, 64, bitmap_scrollbar_background);
  u8g2.drawBox(125, (64 / NUM_ITEMS) * item_selected, 3, 64 / NUM_ITEMS);

  u8g2.sendBuffer();
}

void drawGameMenu() {

  u8g2.clearBuffer();

  u8g2.drawXBMP(0,(64 / GAME_NUM_ITEMS) * game_item_selected,128, 21,bitmap_item_sel_outline);

  u8g2.setFont(u8g_font_7x14);
  u8g2.drawStr(25, 15, game_menu_items[0]);

  u8g2.setFont(u8g_font_7x14);
  u8g2.drawStr(25, 37, game_menu_items[1]);

  u8g2.setFont(u8g_font_7x14);
  u8g2.drawStr(25, 57, game_menu_items[2]);

  u8g2.drawXBMP(120, 0, 8, 64, bitmap_scrollbar_background);
  u8g2.drawBox(125,(64 / GAME_NUM_ITEMS) * game_item_selected,3,64 / GAME_NUM_ITEMS);

  u8g2.sendBuffer();
}

enum GameState {
  STATE_START,
  STATE_WATCH_PHASE,
  STATE_PLAY_PHASE,
  STATE_GAME_OVER
};

//FOR GAME1
GameState currentState = STATE_START;

#define MAX_LEVEL 100
uint8_t sequence[MAX_LEVEL];
int currentLevel = 1;
int playIndex = 0;   // Tracks player's progress in the current sequence
int cursorIndex = 4; // Starts at center tile (0-8 grid)

//FOR GAME2
enum GameState1 { STATE_START1, STATE_PLAY1, STATE_GAME_OVER1 };
GameState1 currentState1 = STATE_START1;

bool needsRedraw = true; // Event-driven rendering flag
bool game2SelectReleased = true;

int mathScore = 0;
char mathQuestion[20];
int mathOptions[4];
int mathCorrectSlot = 0;
int mathCursor = 0; // 0=TopLeft, 1=TopRight, 2=BottomLeft, 3=BottomRight

//FOR GAME3
enum GameState2 { STATE_START2, STATE_MEMORIZE2, STATE_GUESS2, STATE_FEEDBACK2 };
GameState2 currentState2 = STATE_START2;

int currentLevel2 = 1;
int patternLength = 3;
const int MAX_PATTERN_LENGTH = 6; // Fits perfectly on screen

// We now use integers instead of chars to track which icon is in which slot
int originalPattern[10];
int modifiedPattern[10];
int changedIndex = 0;
int cursorIndex2 = 0;
// ==========================================
// 4. BUTTON DEBOUNCING LOGIC
// ==========================================
#define DEBOUNCE_DELAY 50
const char* name;
int i,x,y;
void loading(const char* name,int x, int y) {
  u8g2.clearBuffer();
  u8g2.setFont(u8g2_font_ncenB08_tr);
  u8g2.drawStr(x, y, name);
  u8g2.drawFrame(14,37,100,5);
  u8g2.sendBuffer();
  for(i=0;i<100;i++) {
    u8g2.drawBox(14,37,i,5);
    u8g2.sendBuffer();
  }
}

void beepClick() { tone(BUZZER_PIN, 800, 50); }
void beepIncorrect() { tone(BUZZER_PIN, 400, 300); }
void beepTile() {
  tone(BUZZER_PIN, 1000, 100); // 1000Hz for 100ms
}

void beepTone(int freq, int duration) {
  tone(BUZZER_PIN, freq, duration);
}

void beepSuccess() {
  tone(BUZZER_PIN, 1200, 100); delay(100);
  tone(BUZZER_PIN, 1500, 100); delay(100);
  tone(BUZZER_PIN, 2000, 200); 
}

void beepGameOver() {
  tone(BUZZER_PIN, 200, 500);  // Low buzz, 200Hz for 500ms
}

void generatePattern() {
  // 1. Generate a completely fresh sequence of icon numbers
  for (int i = 0; i < patternLength; i++) {
    originalPattern[i] = random(0, iconSetSize);
    modifiedPattern[i] = originalPattern[i]; // Copy it over
  }

  // 2. Pick ONE random spot to change
  changedIndex = random(0, patternLength);

  // 3. Change it to a guaranteed DIFFERENT icon
  int newIcon;
  do {
    newIcon = random(0, iconSetSize);
  } while (newIcon == originalPattern[changedIndex]);
  
  modifiedPattern[changedIndex] = newIcon;
}
// ==========================================
// 6. GRAPHICS HELPERS (128x64 Version)
// ==========================================
void drawGrid(int highlightedTile, bool showCursor) {
  // Scaled for the rectangular 128x64 screen
  const int tileSize = 14;
  const int gap = 2;
  const int startX = 41;
  const int startY = 16;

  for (int i = 0; i < 9; i++) {
    int col = i % 3;
    int row = i / 3;
    int x = startX + col * (tileSize + gap);
    int y = startY + row * (tileSize + gap);

    // Draw the tile itself
    if (i == highlightedTile) {
      u8g2.drawBox(x, y, tileSize, tileSize); // Filled if active
    } else {
      u8g2.drawFrame(x, y, tileSize, tileSize); // Hollow if inactive
    }

    // Draw the player cursor
    if (showCursor && i == cursorIndex) {
      u8g2.drawFrame(x - 2, y - 2, tileSize + 4, tileSize + 4);
    }
  }
}

struct Button {
  const uint8_t pin;
  bool state;
  bool lastState;
  unsigned long lastDebounceTime;
};

Button btnUp     = {BUTTON_UP_PIN, HIGH, HIGH, 0};
Button btnDown   = {BUTTON_DOWN_PIN, HIGH, HIGH, 0};
Button btnLeft   = {BUTTON_LEFT_PIN, HIGH, HIGH, 0};
Button btnRight  = {BUTTON_RIGHT_PIN, HIGH, HIGH, 0};
Button btnSelect = {BUTTON_SELECT_PIN, HIGH, HIGH, 0};

// Non-blocking button check. Returns true ONLY on the falling edge (press).
bool isButtonPressed(Button &b) {
  bool pressed = false;
  int reading = digitalRead(b.pin);
  
  if (reading != b.lastState) {
    b.lastDebounceTime = millis();
  }
  
  if ((millis() - b.lastDebounceTime) > DEBOUNCE_DELAY) {
    if (reading != b.state) {
      b.state = reading;
      // Button is pressed when LOW (assuming INPUT_PULLUP)
      if (b.state == LOW) {
        pressed = true;
      }
    }
  }
  b.lastState = reading;
  return pressed;
}

void generateMathProblem() {
  int op = random(0, 4); // 0:+, 1:-, 2:*, 3:/
  int num1, num2, ans;

  if (op == 0) { // Addition
    num1 = random(1, 10); num2 = random(1, 10);
    ans = num1 + num2;
    sprintf(mathQuestion, "%d + %d = ?", num1, num2);
  } 
  else if (op == 1) { // Subtraction (No negatives allowed)
    num1 = random(1, 10); num2 = random(1, 10);
    if (num1 < num2) { int t = num1; num1 = num2; num2 = t; } // Swap to ensure num1 is bigger
    ans = num1 - num2;
    sprintf(mathQuestion, "%d - %d = ?", num1, num2);
  } 
  else if (op == 2) { // Multiplication
    num1 = random(1, 10); num2 = random(1, 10);
    ans = num1 * num2;
    sprintf(mathQuestion, "%d x %d = ?", num1, num2);
  } 
  else { // Division (Forces perfect integers)
    num2 = random(1, 10); ans = random(1, 10);
    num1 = num2 * ans; 
    sprintf(mathQuestion, "%d / %d = ?", num1, num2);
  }

  // Pre-fill options with a dummy value to avoid duplicate checking bugs
  for (int i = 0; i < 4; i++) {
    mathOptions[i] = -999;
  }

  // Put the real answer in a random slot
  mathCorrectSlot = random(0, 4);
  mathOptions[mathCorrectSlot] = ans;

  // Generate tricky fake answers for the other 3 slots
  for (int i = 0; i < 4; i++) {
    if (i == mathCorrectSlot) continue; // Skip the real answer
    
    int fake;
    bool isUnique;
    do {
      isUnique = true;
      fake = ans + random(-4, 5); // Pick a number mathematically close to the real one
      if (fake < 0) fake = random(0, 20); // Keep fake answers positive
      
      // Ensure this fake doesn't match the real answer or any other fakes we generated
      for (int j = 0; j < 4; j++) {
        if (j != i && mathOptions[j] == fake) {
          isUnique = false;
        }
      }
    } while (!isUnique);
    
    mathOptions[i] = fake;
  }
}

void Game1() {
  switch (currentState) {
    case STATE_START:
      name = "RECALL";
      loading(name,40,25);
      currentLevel = 1;
      sequence[0] = random(0, 9); // Generate first tile
      cursorIndex = 4;            // Reset cursor to middle
      currentState = STATE_WATCH_PHASE;
      break;

    // ------------------------------------------------
    // STATE: WATCH PHASE (ESP32 plays the pattern)
    // ------------------------------------------------
    case STATE_WATCH_PHASE:
      // Note: We use blocking delay() here because inputs SHOULD be ignored
      for (int i = 0; i < currentLevel; i++) {
        // 1. Show highlighted tile
        u8g2.clearBuffer();
        u8g2.setFont(u8g2_font_ncenB08_tr);
        u8g2.drawStr(0, 10, "Watch...");
        u8g2.setCursor(95, 10); u8g2.print("Lvl:"); u8g2.print(currentLevel);
        
        drawGrid(sequence[i], false); // No cursor shown while watching
        u8g2.sendBuffer();
        
        beepTile();
        delay(400); // Duration the tile stays illuminated

        // 2. Turn off highlight for the gap between tiles
        u8g2.clearBuffer();
        u8g2.drawStr(0, 10, "Watch...");
        u8g2.setCursor(95, 10); u8g2.print("Lvl:"); u8g2.print(currentLevel);
        
        drawGrid(-1, false); // -1 means nothing highlighted
        u8g2.sendBuffer();
        
        delay(200); // Gap duration
      }
      
      playIndex = 0; // Reset player progress for their turn
      currentState = STATE_PLAY_PHASE;
      break;

    // ------------------------------------------------
    // STATE: PLAY PHASE (Player inputs the pattern)
    // ------------------------------------------------
    case STATE_PLAY_PHASE:
      // Render Screen
      u8g2.clearBuffer();
      u8g2.setFont(u8g2_font_ncenB08_tr);
      u8g2.drawStr(0, 10, "Your Turn!");
      u8g2.setCursor(95, 10); u8g2.print("Lvl:"); u8g2.print(currentLevel);
      drawGrid(-1, true); // No tile filled, but show cursor
      u8g2.sendBuffer();

      // Handle Input - D-Pad Constraints
      if (isButtonPressed(btnUp) && cursorIndex > 2) {
        cursorIndex -= 3;
      }
      if (isButtonPressed(btnDown) && cursorIndex < 6) {
        cursorIndex += 3;
      }
      if (isButtonPressed(btnLeft) && (cursorIndex % 3) > 0) {
        cursorIndex -= 1;
      }
      if (isButtonPressed(btnRight) && (cursorIndex % 3) < 2) {
        cursorIndex += 1;
      }

      // Handle Input - Selection
      if (isButtonPressed(btnSelect)) {
        // Visual & audio feedback of player's press
        u8g2.clearBuffer();
        u8g2.drawStr(0, 10, "Your Turn!");
        u8g2.setCursor(95, 10); u8g2.print("Lvl:"); u8g2.print(currentLevel);
        drawGrid(cursorIndex, true); // Fill selected tile
        u8g2.sendBuffer();
        
        beepTile();
        delay(200); // Brief visual confirmation pause

        // Game Logic Evaluation
        if (cursorIndex == sequence[playIndex]) {
          // Correct tile selected!
          playIndex++;
          
          if (playIndex == currentLevel) {
            // Level completed successfully!
            beepSuccess();
            delay(300);
            
            // Advance level
            if (currentLevel < MAX_LEVEL) {
              sequence[currentLevel] = random(0, 9); // Add new step
              currentLevel++;
            }
            currentState = STATE_WATCH_PHASE;
            delay(500); // Pause before next sequence
          }
        } else {
          // Wrong tile selected!
          beepGameOver();
          currentState = STATE_GAME_OVER;
        }
      }
      break;

    // ------------------------------------------------
    // STATE: GAME OVER
    // ------------------------------------------------
    case STATE_GAME_OVER:
      u8g2.clearBuffer();
      u8g2.setFont(u8g2_font_ncenB08_tr);

      if (maxcurrentLevel < currentLevel){
         maxcurrentLevel = currentLevel-1;
         bot.sendMessage(CHANNEL_ID, "/game1 Level" + String(maxcurrentLevel),      "");
      }
      
      // Coordinates set for 128x64 screen
      u8g2.drawStr(30, 25, "GAME OVER!");
      
      u8g2.setCursor(20, 45);
      u8g2.print("Reached Lvl: ");
      u8g2.print(currentLevel);
      
      u8g2.sendBuffer();

      // Wait for select to restart the game loop
      if (isButtonPressed(btnSelect)) {
        currentState = STATE_START;
      }
      break;
  }
}

void Game2 () {
  
  switch (currentState1) {

    // ------------------------------------------------
    // STATE: START SCREEN
    // ------------------------------------------------
    case STATE_START1:
  if (needsRedraw) {
    name = "QUICK MATH";
    loading(name,24,25);
    needsRedraw = false;
  }

    mathScore = 0;
    mathCursor = 0;
    generateMathProblem();

    currentState1 = STATE_PLAY1;
    needsRedraw = true;
  
  break;
    // ------------------------------------------------
    // STATE: PLAY PHASE
    // ------------------------------------------------
    case STATE_PLAY1:
      if (needsRedraw) {
        u8g2.clearBuffer();
        
        // 1. Draw Score
        u8g2.setFont(u8g2_font_ncenB08_tr);
        u8g2.setCursor(0, 10); u8g2.print("Score: "); u8g2.print(mathScore);
        
        // 2. Draw Math Question (Auto-centered!)
        u8g2.setFont(u8g2_font_ncenB10_tr); 
        int textWidth = u8g2.getStrWidth(mathQuestion);
        u8g2.setCursor((128 - textWidth) / 2, 28); 
        u8g2.print(mathQuestion);

        // 3. Draw 2x2 Options Grid
        u8g2.setFont(u8g2_font_ncenB08_tr);
        for (int i = 0; i < 4; i++) {
          int boxX = (i % 2 == 0) ? 14 : 74; // Column 1 or Column 2
          int boxY = (i < 2) ? 34 : 49;      // Row 1 or Row 2
          
          // Draw bounding box if cursor is highlighting this option
          if (i == mathCursor) {
            u8g2.drawFrame(boxX, boxY, 40, 14); // 40px wide, 14px tall
          }
          
          // Draw the option text inside the box
          int optWidth = u8g2.getStrWidth(String(mathOptions[i]).c_str());
          u8g2.setCursor(boxX + (40 - optWidth) / 2, boxY + 11); // Center text in box
          u8g2.print(mathOptions[i]);
        }
        
        u8g2.sendBuffer();
        needsRedraw = false;
      }

      // 4. Handle 2x2 Grid Movement
      // mathCursor indices: 0(TL), 1(TR), 2(BL), 3(BR)
      if (isButtonPressed(btnUp) && mathCursor > 1) { 
        mathCursor -= 2; needsRedraw = true; 
      }
      if (isButtonPressed(btnDown) && mathCursor < 2) { 
        mathCursor += 2; needsRedraw = true; 
      }
      if (isButtonPressed(btnLeft) && (mathCursor % 2 != 0)) { 
        mathCursor -= 1; needsRedraw = true; 
      }
      if (isButtonPressed(btnRight) && (mathCursor % 2 == 0)) { 
        mathCursor += 1; needsRedraw = true; 
      }

      // 5. Handle Selection
      if (game2SelectReleased && isButtonPressed(btnSelect)) {

        game2SelectReleased = false;

        if (mathCursor == mathCorrectSlot) {
          // Correct!
          beepTone(1000, 100);
          mathScore++;
          generateMathProblem(); // Instantly create the next level
        } else {
          // Wrong!
          beepGameOver();
          currentState1 = STATE_GAME_OVER1;
        }
        needsRedraw = true;
      }
      // Allow another Select press only after button is released
      if (digitalRead(BUTTON_SELECT_PIN) == HIGH) {
          game2SelectReleased = true;
      }

      break;

    // ------------------------------------------------
    // STATE: GAME OVER
    // ------------------------------------------------
    case STATE_GAME_OVER1:
      if (needsRedraw) {
        u8g2.clearBuffer();
        u8g2.setFont(u8g2_font_ncenB08_tr);
        u8g2.drawStr(30, 25, "GAME OVER!");
        
        u8g2.setCursor(40, 45); 
        u8g2.print("Score: "); 
        u8g2.print(mathScore);
        
        u8g2.sendBuffer();
        needsRedraw = false;
      }

      if (isButtonPressed(btnSelect)) {
        currentState1 = STATE_START1;
        needsRedraw = true;
      }
       if (maxcurrentLevel1 < mathScore){
         maxcurrentLevel1 = mathScore;
         bot.sendMessage(CHANNEL_ID, "/game2 Level" + String(maxcurrentLevel1),      "");
      }
      break;
  }
}

void Game3() {
  switch (currentState2) {

    // ------------------------------------------------
    // STATE 1: START SCREEN
    // ------------------------------------------------
    case STATE_START2:
      if (needsRedraw) {
        name = "SPOT DIFF";
        loading(name,28,25);
        needsRedraw = false;
      }

        currentLevel2 = 1;
        patternLength = 3;
        generatePattern();
        currentState2 = STATE_MEMORIZE2;
        needsRedraw = true;
      break;

    // ------------------------------------------------
    // STATE 2: MEMORIZE (Patient takes their time)
    // ------------------------------------------------
    case STATE_MEMORIZE2:
      if (needsRedraw) {
        u8g2.clearBuffer();
        u8g2.setFont(u8g2_font_ncenB08_tr);
        
        u8g2.setCursor(0, 10); u8g2.print("Lvl: "); u8g2.print(currentLevel2);
        u8g2.drawStr(45, 10, "Memorize");
        
        // --- DRAW THE BITMAP ICONS ---
        int spacing = 20;
        int totalWidth = (patternLength - 1) * spacing + 16;
        int startX = (128 - totalWidth) / 2; // Auto-centers perfectly
        
        for (int i = 0; i < patternLength; i++) {
          int iconX = startX + (i * spacing);
          // drawXBMP takes (X, Y, Width, Height, Array)
          u8g2.drawXBMP(iconX, 26, 16, 16, iconSet[originalPattern[i]]);
        }

        u8g2.drawStr(10, 60, "Press Select to Start");
        u8g2.sendBuffer();
        needsRedraw = false;
      }

      if (isButtonPressed(btnSelect)) {
        cursorIndex2 = 0; 
        currentState2 = STATE_GUESS2;
        needsRedraw = true;
      }
      break;

    // ------------------------------------------------
    // STATE 3: GUESS (Find what changed)
    // ------------------------------------------------
    case STATE_GUESS2:
      if (needsRedraw) {
        u8g2.clearBuffer();
        u8g2.setFont(u8g2_font_ncenB08_tr);
        
        u8g2.setCursor(0, 10); u8g2.print("Lvl: "); u8g2.print(currentLevel2);
        u8g2.drawStr(40, 10, "What changed?");
        
        int spacing = 20;
        int totalWidth = (patternLength - 1) * spacing + 16;
        int startX = (128 - totalWidth) / 2; 
        
        for (int i = 0; i < patternLength; i++) {
          int iconX = startX + (i * spacing);
          
          u8g2.drawXBMP(iconX, 26, 16, 16, iconSet[modifiedPattern[i]]);
          
          // Draw a thick cursor line underneath the selected icon
          if (i == cursorIndex2) {
            u8g2.drawLine(iconX - 1, 46, iconX + 16, 46);
            u8g2.drawLine(iconX - 1, 47, iconX + 16, 47); 
          }
        }
        
        u8g2.sendBuffer();
        needsRedraw = false;
      }

      if (isButtonPressed(btnLeft) && cursorIndex2 > 0) { 
        cursorIndex2--; needsRedraw = true; beepClick(); 
      }
      if (isButtonPressed(btnRight) && cursorIndex2 < (patternLength - 1)) { 
        cursorIndex2++; needsRedraw = true; beepClick(); 
      }

      if (isButtonPressed(btnSelect)) {
        if (cursorIndex2 == changedIndex) {
          // CORRECT: Instantly go to next level!
          beepSuccess();
          currentLevel2++;
          
          patternLength = 3 + (currentLevel2 / 2);
          if (patternLength > MAX_PATTERN_LENGTH) {
            patternLength = MAX_PATTERN_LENGTH;
          }
          
          generatePattern();
          currentState2 = STATE_MEMORIZE2; 
          delay(400); // Visual pause so they hear the success sound before screen wipes
          
        } else {
          // INCORRECT: Go to feedback screen
          beepIncorrect();
          currentState2 = STATE_FEEDBACK2;
        }
        needsRedraw = true;
      }
      break;

    // ------------------------------------------------
    // STATE 4: FEEDBACK (Only shown if incorrect)
    // ------------------------------------------------
    case STATE_FEEDBACK2:
      if (needsRedraw) {
        u8g2.clearBuffer();
        u8g2.setFont(u8g2_font_ncenB08_tr);
        
        u8g2.drawStr(38, 10, "Nice Try!");
        u8g2.drawStr(10, 25, "The change was here:");
        
        // Show exactly which icon was the right answer
        int spacing = 20;
        int totalWidth = (patternLength - 1) * spacing + 16;
        int startX = (128 - totalWidth) / 2;
        int iconX = startX + (changedIndex * spacing);
        
        u8g2.drawXBMP(iconX, 31, 16, 16, iconSet[modifiedPattern[changedIndex]]);
        u8g2.drawLine(iconX - 1, 51, iconX + 16, 51);
        
        u8g2.drawStr(25, 62, "[Press Select]");
        u8g2.sendBuffer();
        needsRedraw = false;
      }

      if (isButtonPressed(btnSelect)) {
        generatePattern();
        currentState2 = STATE_MEMORIZE2;
        needsRedraw = true;
      }
      
      if (isButtonPressed(btnUp) && isButtonPressed(btnDown)) {
        currentState2 = STATE_START2;
        needsRedraw = true;
      }
       if (maxcurrentLevel2 < currentLevel2){
         maxcurrentLevel2 = currentLevel2 - 1;
         bot.sendMessage(CHANNEL_ID, "/game3 Level" + String(maxcurrentLevel2),      "");
      }
      break;
  }
}

void drawYogaMenu() {

  u8g2.clearBuffer();

  u8g2.drawXBMP(0,(64 / YOGA_NUM_ITEMS) * yoga_item_selected,128, 21,bitmap_item_sel_outline );

  u8g2.setFont(u8g_font_7x14B);
  u8g2.drawStr(25, 15, yoga_menu_items[0]);

  u8g2.setFont(u8g_font_7x14B);
  u8g2.drawStr(25, 37, yoga_menu_items[1]);

  u8g2.setFont(u8g_font_7x14B);
  u8g2.drawStr(25, 57, yoga_menu_items[2]);

  u8g2.drawXBMP(120, 0, 8, 64, bitmap_scrollbar_background);
  u8g2.drawBox(125,(64 / YOGA_NUM_ITEMS) * yoga_item_selected,3, 64 / YOGA_NUM_ITEMS);

  u8g2.sendBuffer();
}

void drawYoga1() {

  u8g2.clearBuffer();

  if (currentFrame == 0) {
    u8g2.drawXBMP(0, 0, 64, 64, YOGA[0]);
    u8g2.drawXBMP(64, 0, 64, 64, YOGA[1]);
  } else {
    u8g2.drawXBMP(0, 0, 64, 64, YOGA[2]);
    u8g2.drawXBMP(64, 0, 64, 64, YOGA[3]);
  }

  u8g2.sendBuffer();
}

void drawYoga2() {
  
  u8g2.clearBuffer();

  if (currentFrame == 0) {
    u8g2.drawXBMP(0, 0, 64, 64, YOGA[4]);
    u8g2.drawXBMP(64, 0, 64, 64, YOGA[5]);
  } else {
    u8g2.drawXBMP(0, 0, 64, 64, YOGA[6]);
    u8g2.drawXBMP(64, 0, 64, 64, YOGA[7]);
  }

  u8g2.sendBuffer();
}

void drawYoga3() {
  
  u8g2.clearBuffer();

  if (currentFrame == 0) {
    u8g2.drawXBMP(0, 0, 64, 64, YOGA[9]);
    u8g2.drawXBMP(64, 0, 64, 64, YOGA[8]);
  } else {
    u8g2.drawXBMP(0, 0, 64, 64, YOGA[11]);
    u8g2.drawXBMP(64, 0, 64, 64, YOGA[10]);
  }

  u8g2.sendBuffer();
}

void drawEmergencyScreen() {
  u8g2.clearBuffer();

  u8g2.setFont(u8g2_font_6x10_tr);

  u8g2.drawBox(0, 0, 128, 14);
  u8g2.setDrawColor(0);
  u8g2.drawStr(18, 11, "EMERGENCY ALERT");
  u8g2.setDrawColor(1);

  u8g2.drawRFrame(2, 17, 124, 29, 3);

  if (selected == 0) {
    u8g2.drawStr(14, 29, "Medical Emergency");
    u8g2.drawStr(22, 41, "Need help now!");
  }
  else if (selected == 1) {
    u8g2.drawStr(22, 29, "Fall Detected");
    u8g2.drawStr(12, 41, "Please check on me");
  }
  else if (selected == 2) {
    u8g2.drawStr(18, 29, "Need Assistance");
    u8g2.drawStr(30, 41, "Not urgent");
  }
  else {
    u8g2.drawStr(36, 29, "I'm OK");
    u8g2.drawStr(18, 41, "Just checking in");
  }

  u8g2.drawTriangle(26, 56, 32, 50, 32, 62);
  u8g2.drawTriangle(102, 56, 96, 50, 96, 62);

  u8g2.drawRBox(38, 48, 52, 15, 3);
  u8g2.setDrawColor(0);
  u8g2.drawStr(52, 60, "SEND");
  u8g2.setDrawColor(1);

  u8g2.sendBuffer();
}

void drawReminderMenu() {

  u8g2.clearBuffer();

  // Header
  u8g2.setFont(u8g2_font_6x10_tr);

  u8g2.drawBox(0, 0, 128, 14);

  u8g2.setDrawColor(0);
  u8g2.drawStr(38, 11, "REMINDERS");

  u8g2.setDrawColor(1);

  int totalReminders = getReminderMenuCount();

  // No reminders
  if (totalReminders == 0) {

    u8g2.drawStr(32, 32, "No Reminders");
    u8g2.drawStr(18, 52, "LEFT: Back");

    u8g2.sendBuffer();
    return;
  }

  // Show up to 3 reminders
  const int VISIBLE_ITEMS = 3;

  if (reminder_menu_selected < reminder_menu_scroll) {
    reminder_menu_scroll = reminder_menu_selected;
  }

  if (reminder_menu_selected >= reminder_menu_scroll + VISIBLE_ITEMS) {
    reminder_menu_scroll =
      reminder_menu_selected - VISIBLE_ITEMS + 1;
  }

  int endItem = reminder_menu_scroll + VISIBLE_ITEMS;

  if (endItem > totalReminders) {
    endItem = totalReminders;
  }

  int y = 20;

  for (int menuIndex = reminder_menu_scroll;
       menuIndex < endItem;
       menuIndex++) {

    int arrayIndex = getReminderArrayIndex(menuIndex);

    if (arrayIndex == -1) {
      continue;
    }

    // Selected reminder
    if (menuIndex == reminder_menu_selected) {

      u8g2.drawRBox(1, y - 9, 126, 15, 2);

      u8g2.setDrawColor(0);
    }

    char timeText[10];

    snprintf(
      timeText,
      sizeof(timeText),
      "%02d:%02d",
      reminders[arrayIndex].hour,
      reminders[arrayIndex].minute
    );

    u8g2.drawStr(5, y, timeText);

    // Shorten text for OLED
    String displayText = reminders[arrayIndex].text;

    if (displayText.length() > 14) {
      displayText = displayText.substring(0, 14);
    }

    u8g2.drawStr(
      38,
      y,
      displayText.c_str()
    );

    if (menuIndex == reminder_menu_selected) {
      u8g2.setDrawColor(1);
    }

    y += 16;
  }

  // Bottom instructions
  u8g2.setFont(u8g2_font_5x7_tr);

  u8g2.drawStr(3, 63, "SEL: Clear");

  u8g2.drawStr(80, 63, "LEFT: Back");

  u8g2.sendBuffer();
}
// -------------------- SETUP --------------------

void setup() {
  Serial.begin(115200);

  // Classic ESP32 I2C pins:
  Wire.begin(21, 22);

  u8g2.begin();
  u8g2.setDrawColor(1);
  u8g2.setBitmapMode(1);

  pinMode(BUTTON_UP_PIN, INPUT_PULLUP);
  pinMode(BUTTON_SELECT_PIN, INPUT_PULLUP);
  pinMode(BUTTON_DOWN_PIN, INPUT_PULLUP);
  pinMode(BUTTON_LEFT_PIN, INPUT_PULLUP);
  pinMode(BUTTON_RIGHT_PIN, INPUT_PULLUP);
  pinMode(BUTTON_BACK_PIN, INPUT_PULLUP);;
  pinMode(BUZZER_PIN, OUTPUT);

    // Seed RNG via floating analog pin
  randomSeed(analogRead(RANDOM_SEED_PIN));

  client.setInsecure();

  WiFi.begin(WIFI_SSID, WIFI_PASSWORD);
  Serial.print("Connecting to WiFi");

  // Do not block the entire device forever if WiFi is unavailable.
  unsigned long wifiStart = millis();
  const unsigned long WIFI_TIMEOUT = 15000;

  while (WiFi.status() != WL_CONNECTED &&
         millis() - wifiStart < WIFI_TIMEOUT) {
    delay(250);
    Serial.print(".");
  }

  Serial.println();

  if (WiFi.status() == WL_CONNECTED) {
    Serial.println("WiFi connected!");
    Serial.println(WiFi.localIP());
  } else {
    Serial.println("WiFi connection timeout.");
    Serial.println("Device will continue offline.");
  }

  setupReminderSystem(); // starts NTP sync for the reminder clock

  // Create synchronization objects before starting background tasks.
  reminderMutex = xSemaphoreCreateMutex();
  telegramMutex = xSemaphoreCreateMutex();

  // Telegram network work is isolated from the fast UI loop.
  xTaskCreatePinnedToCore(
    reminderTask, "ReminderTask", 8192, NULL, 1, &reminderTaskHandle, 0
  );

  xTaskCreatePinnedToCore(
    telegramTask, "TelegramTask", 8192, NULL, 1, &telegramTaskHandle, 0
  );

  drawMainMenu();
}

// -------------------- MAIN MENU --------------------

void handleMainMenu() {
  if (digitalRead(BUTTON_UP_PIN) == LOW && button_up_clicked == 0) {
    button_up_clicked = 1;
    item_selected--;
    if (item_selected < 0) item_selected = NUM_ITEMS - 1;
    tone(BUZZER_PIN, 880, 50);
  }

  if (digitalRead(BUTTON_UP_PIN) == HIGH) {
    button_up_clicked = 0;
  }

  if (digitalRead(BUTTON_DOWN_PIN) == LOW && button_down_clicked == 0) {
    button_down_clicked = 1;
    item_selected++;
    if (item_selected >= NUM_ITEMS) item_selected = 0;
    tone(BUZZER_PIN, 440, 50);
  }

  if (digitalRead(BUTTON_DOWN_PIN) == HIGH) {
    button_down_clicked = 0;
  }

  if (digitalRead(BUTTON_SELECT_PIN) == LOW &&
      button_select_clicked == 0) {

    button_select_clicked = 1;
    tone(BUZZER_PIN, 1200, 150);

    if (item_selected == 0) {
      current_screen = 1;
      game_current_screen = 0;
      game_item_selected = 0;
      resetInputFlags();
      game_button_select_clicked = 1;
    }
    else if (item_selected == 1) {
      current_screen = 2;
      yoga_current_screen = 0;
      yoga_item_selected = 0;
      resetInputFlags();
      yoga_button_select_clicked = 1;
    }
    else if (item_selected == 2) {

  current_screen = 4;

  reminder_menu_selected = 0;
  reminder_menu_scroll = 0;

  resetInputFlags();

  reminder_button_select_clicked = 1;
}
    else if (item_selected == 3) {
      current_screen = 3;
      selected = 0;
      resetInputFlags();
      eg_button_select_clicked = 1;
    }
  }

  if (digitalRead(BUTTON_SELECT_PIN) == HIGH) {
    button_select_clicked = 0;
  }

  drawMainMenu();
}

void handleReminderMenu() {

  int totalReminders = getReminderMenuCount();

  // If there are no reminders
  if (totalReminders == 0) {

    reminder_menu_selected = 0;
    reminder_menu_scroll = 0;

  } else {

    // ---------------- UP ----------------
    if (digitalRead(BUTTON_UP_PIN) == LOW &&
        reminder_button_up_clicked == 0) {

      reminder_button_up_clicked = 1;

      reminder_menu_selected--;

      if (reminder_menu_selected < 0) {
        reminder_menu_selected = totalReminders - 1;
      }

      tone(BUZZER_PIN, 880, 50);
    }

    if (digitalRead(BUTTON_UP_PIN) == HIGH) {
      reminder_button_up_clicked = 0;
    }


    // ---------------- DOWN ----------------
    if (digitalRead(BUTTON_DOWN_PIN) == LOW &&
        reminder_button_down_clicked == 0) {

      reminder_button_down_clicked = 1;

      reminder_menu_selected++;

      if (reminder_menu_selected >= totalReminders) {
        reminder_menu_selected = 0;
      }

      tone(BUZZER_PIN, 440, 50);
    }

    if (digitalRead(BUTTON_DOWN_PIN) == HIGH) {
      reminder_button_down_clicked = 0;
    }


    // ---------------- SELECT = CLEAR ----------------
    if (digitalRead(BUTTON_SELECT_PIN) == LOW &&
        reminder_button_select_clicked == 0) {

      reminder_button_select_clicked = 1;

      int arrayIndex =
        getReminderArrayIndex(reminder_menu_selected);

      if (arrayIndex != -1) {

        if (reminderMutex) {
          xSemaphoreTake(
            reminderMutex,
            portMAX_DELAY
          );
        }

        reminders[arrayIndex].active = false;
        reminders[arrayIndex].used = false;
        reminders[arrayIndex].text = "";

        if (reminderMutex) {
          xSemaphoreGive(reminderMutex);
        }

        tone(BUZZER_PIN, 1200, 100);

        // Correct selected position
        totalReminders = getReminderMenuCount();

        if (reminder_menu_selected >= totalReminders &&
            totalReminders > 0) {

          reminder_menu_selected =
            totalReminders - 1;
        }

        if (totalReminders == 0) {
          reminder_menu_selected = 0;
          reminder_menu_scroll = 0;
        }
      }
    }

    if (digitalRead(BUTTON_SELECT_PIN) == HIGH) {
      reminder_button_select_clicked = 0;
    }
  }


  // ---------------- LEFT = BACK ----------------
  if (digitalRead(BUTTON_BACK_PIN) == LOW &&
      reminder_button_left_clicked == 0) {

    reminder_button_left_clicked = 1;

    current_screen = 0;

    resetInputFlags();

    tone(BUZZER_PIN, 800, 80);

    return;
  }

  if (digitalRead(BUTTON_BACK_PIN) == HIGH) {
    reminder_button_left_clicked = 0;
  }


  drawReminderMenu();
}

// -------------------- GAME SUBMENU --------------------

void handleGameMenu() {

  // If we're actually inside Game 1, run its own state machine
  // and handle LEFT (back to game menu) here, then bail out.
  if (game_current_screen == 1) {
    if (digitalRead(BUTTON_BACK_PIN) == LOW && game_button_left_clicked == 0) {
      game_button_left_clicked = 1;
      game_current_screen = 0;   // back to game menu, not main menu
      tone(BUZZER_PIN, 800, 80);
      return;
    }
    if (digitalRead(BUTTON_BACK_PIN) == HIGH) {
      game_button_left_clicked = 0;
    }

    Game1();
    return;
  }

  if (game_current_screen == 2) {
    if (digitalRead(BUTTON_BACK_PIN) == LOW && game_button_left_clicked == 0) {
      game_button_left_clicked = 1;
      game_current_screen = 0;   // back to game menu, not main menu
      tone(BUZZER_PIN, 800, 80);
      return;
    }
    if (digitalRead(BUTTON_BACK_PIN) == HIGH) {
      game_button_left_clicked = 0;
    }

    Game2();
    return;
  }

    if (game_current_screen == 3) {
    if (digitalRead(BUTTON_BACK_PIN) == LOW && game_button_left_clicked == 0) {
      game_button_left_clicked = 1;
      game_current_screen = 0;   // back to game menu, not main menu
      tone(BUZZER_PIN, 800, 80);
      return;
    }
    if (digitalRead(BUTTON_BACK_PIN) == HIGH) {
      game_button_left_clicked = 0;
    }

    Game3();
    return;
  }
  // ---- game_current_screen == 0: show the Game 1/2/3 select menu ----

  if (digitalRead(BUTTON_UP_PIN) == LOW && game_button_up_clicked == 0) {
    game_button_up_clicked = 1;
    game_item_selected--;
    if (game_item_selected < 0) game_item_selected = GAME_NUM_ITEMS - 1;
    tone(BUZZER_PIN, 880, 50);
  }
  if (digitalRead(BUTTON_UP_PIN) == HIGH) game_button_up_clicked = 0;

  if (digitalRead(BUTTON_DOWN_PIN) == LOW && game_button_down_clicked == 0) {
    game_button_down_clicked = 1;
    game_item_selected++;
    if (game_item_selected >= GAME_NUM_ITEMS) game_item_selected = 0;
    tone(BUZZER_PIN, 440, 50);
  }
  if (digitalRead(BUTTON_DOWN_PIN) == HIGH) game_button_down_clicked = 0;

  if (digitalRead(BUTTON_SELECT_PIN) == LOW && game_button_select_clicked == 0) {
    game_button_select_clicked = 1;
    tone(BUZZER_PIN, 1200, 150);

    if (game_item_selected == 0) {
      game_current_screen = 1;
      currentState = STATE_START;
      currentLevel = 1;
      playIndex = 0;
      cursorIndex = 4;
    }
    else if (game_item_selected == 1) {
      game_current_screen = 2;
      game2SelectReleased = false;
    }
    else if (game_item_selected == 2) {
      game_current_screen = 3;   // Game 3 not implemented yet
      currentState2 = STATE_START2;
      currentLevel2 = 1;
      int patternLength = 3;
      cursorIndex2 = 0;
      needsRedraw = true;
    }
    return; // re-enter next loop() with the new screen already set
  }
  if (digitalRead(BUTTON_SELECT_PIN) == HIGH) game_button_select_clicked = 0;

  if (digitalRead(BUTTON_BACK_PIN) == LOW && game_button_left_clicked == 0) {
    game_button_left_clicked = 1;
    current_screen = 0;
    resetInputFlags();
    tone(BUZZER_PIN, 800, 80);
    return;
  }
  if (digitalRead(BUTTON_BACK_PIN) == HIGH) game_button_left_clicked = 0;

  drawGameMenu();
}
// -------------------- YOGA SUBMENU --------------------
int startTime;
int endTime;
int timeMin;
void handleYogaMenu() {
  if (yoga_current_screen == 0) {

    if (digitalRead(BUTTON_UP_PIN) == LOW &&
        yoga_button_up_clicked == 0) {

      yoga_button_up_clicked = 1;
      yoga_item_selected--;

      if (yoga_item_selected < 0) {
        yoga_item_selected = YOGA_NUM_ITEMS - 1;
      }

      tone(BUZZER_PIN, 880, 50);
    }

    if (digitalRead(BUTTON_UP_PIN) == HIGH) {
      yoga_button_up_clicked = 0;
    }

    if (digitalRead(BUTTON_DOWN_PIN) == LOW &&
        yoga_button_down_clicked == 0) {

      yoga_button_down_clicked = 1;
      yoga_item_selected++;

      if (yoga_item_selected >= YOGA_NUM_ITEMS) {
        yoga_item_selected = 0;
      }

      tone(BUZZER_PIN, 440, 50);
    }

    if (digitalRead(BUTTON_DOWN_PIN) == HIGH) {
      yoga_button_down_clicked = 0;
    }

    if (digitalRead(BUTTON_SELECT_PIN) == LOW &&
        yoga_button_select_clicked == 0) {

      yoga_button_select_clicked = 1;
      tone(BUZZER_PIN, 1200, 150);

      // Each yoga item gets its own screen.
      if (yoga_item_selected == 0) {
        yoga_current_screen = 1;   // Yoga 1
      }
      else if (yoga_item_selected == 1) {
        yoga_current_screen = 2;   // Yoga 2
      }
      else {
        yoga_current_screen = 3;   // Yoga 3
      }

      startTime = millis();
      // Start Yoga 1 animation from the first frame.
      currentFrame = 0;
      lastFrameTime = millis();
    }

    if (digitalRead(BUTTON_SELECT_PIN) == HIGH) {
      yoga_button_select_clicked = 0;
    }

    // LEFT from Yoga menu -> main menu
    if (digitalRead(BUTTON_BACK_PIN) == LOW &&
        yoga_button_left_clicked == 0) {

      yoga_button_left_clicked = 1;
      current_screen = 0;
      yoga_current_screen = 0;
      resetInputFlags();
      tone(BUZZER_PIN, 800, 80);
      return;
    }

    if (digitalRead(BUTTON_BACK_PIN) == HIGH) {
      yoga_button_left_clicked = 0;
    }

    drawYogaMenu();
    return;
  }

  // -------------------- YOGA IMAGE SCREEN --------------------
  //
  // No blocking while() is used here.
  // The old code entered a blocking loop while LEFT was held,
  // which made navigation unreliable.
  //
  // A SHORT press of LEFT returns to Yoga menu.
  // A LONG press also returns to Yoga menu, but only once.
  // Neither can accidentally jump directly to the main menu.

  if (digitalRead(BUTTON_BACK_PIN) == LOW) {

    if (!leftPressActive) {
      leftPressActive = true;
      leftLongPressHandled = false;
      leftPressStart = millis();
        timeMin = timeMin + (endTime-startTime)/(60*1000);
  bot.sendMessage(
      CHANNEL_ID,"/yoga"+String(yoga_current_screen)+" "+
      String(timeMin),
      ""
    );
    }

    if (!leftLongPressHandled &&
        millis() - leftPressStart >= LONG_PRESS_TIME) {

      leftLongPressHandled = true;
      yoga_current_screen = 0;
      currentFrame = 0;
      lastFrameTime = millis();
      endTime = millis();
      tone(BUZZER_PIN, 800, 100);
      timeMin = timeMin + (endTime-startTime)/(60*1000);
      bot.sendMessage(
      CHANNEL_ID,"/yoga"+String(yoga_current_screen)+" "+
      String(timeMin),
      ""
    );

      // Wait for release without blocking the display loop.
      // The release is handled below.
    }
  }
  else {
    if (leftPressActive) {

      // If it was released before the long-press threshold,
      // treat it as a normal BACK operation.
      if (!leftLongPressHandled) {
        yoga_current_screen = 0;
        currentFrame = 0;
        lastFrameTime = millis();
        tone(BUZZER_PIN, 800, 80);
      }

      leftPressActive = false;
      leftLongPressHandled = false;
    }
  }

  // Draw Yoga 1/2/3.
  //
  // The original file only supplied an animated frame sequence for
  // Yoga 1. Until separate Yoga 2/3 display logic is added, use the
  // same safe screen behavior instead of showing an uninitialized
  // buffer.
  if (yoga_current_screen == 1) {

    if (millis() - lastFrameTime >= FRAME_INTERVAL) {
      lastFrameTime = millis();
      currentFrame = !currentFrame;
    }

    drawYoga1();
  }
  if (yoga_current_screen == 2) {

    if (millis() - lastFrameTime >= FRAME_INTERVAL) {
      lastFrameTime = millis();
      currentFrame = !currentFrame;
    }

    drawYoga2();
  }
    if (yoga_current_screen == 3) {

    if (millis() - lastFrameTime >= FRAME_INTERVAL) {
      lastFrameTime = millis();
      currentFrame = !currentFrame;
    }

    drawYoga3();
  }
}

// -------------------- EMERGENCY --------------------

void sendTelegramMessage() {
  u8g2.clearBuffer();
  u8g2.setFont(u8g2_font_6x12_tf);
  u8g2.drawStr(0, 20, "Sending...");
  u8g2.sendBuffer();

  Serial.println("Sending Telegram message:");
  Serial.println(messages[selected]);

  bool result = false;

  if (WiFi.status() == WL_CONNECTED) {
    result = bot.sendMessage(
      CHANNEL_ID,
      messages[selected],
      ""
    );
  }

  u8g2.clearBuffer();
  u8g2.setFont(u8g2_font_6x12_tf);

  if (result) {
    Serial.println("Message sent!");
    u8g2.drawStr(0, 20, "Message sent!");
  }
  else {
    Serial.println("Message failed!");
    u8g2.drawStr(0, 20, "Send failed!");
  }

  u8g2.sendBuffer();
  delay(1500);

  drawEmergencyScreen();
}

void handleEmergency() {

  // UP - previous message
  if (digitalRead(BUTTON_UP_PIN) == LOW &&
      eg_button_up_clicked == 0 &&
      millis() - lastButtonTime >= debounceTime) {

    eg_button_up_clicked = 1;
    lastButtonTime = millis();

    selected--;
    if (selected < 0) {
      selected = messageCount - 1;
    }

    tone(BUZZER_PIN, 880, 50);
  }

  if (digitalRead(BUTTON_UP_PIN) == HIGH) {
    eg_button_up_clicked = 0;
  }

  // DOWN - next message
  if (digitalRead(BUTTON_DOWN_PIN) == LOW &&
      eg_button_down_clicked == 0 &&
      millis() - lastButtonTime >= debounceTime) {

    eg_button_down_clicked = 1;
    lastButtonTime = millis();

    selected++;
    if (selected >= messageCount) {
      selected = 0;
    }

    tone(BUZZER_PIN, 440, 50);
  }

  if (digitalRead(BUTTON_DOWN_PIN) == HIGH) {
    eg_button_down_clicked = 0;
  }

  // SELECT - send exactly once per press
  if (digitalRead(BUTTON_SELECT_PIN) == LOW &&
      eg_button_select_clicked == 0 &&
      millis() - lastButtonTime >= debounceTime) {

    eg_button_select_clicked = 1;
    lastButtonTime = millis();

    tone(BUZZER_PIN, 1200, 150);
    sendTelegramMessage();
  }

  if (digitalRead(BUTTON_SELECT_PIN) == HIGH) {
    eg_button_select_clicked = 0;
  }

  // LEFT - return to main menu
  if (digitalRead(BUTTON_BACK_PIN) == LOW &&
      button_left_clicked == 0) {

    button_left_clicked = 1;
    current_screen = 0;
    yoga_current_screen = 0;
    resetInputFlags();

    tone(BUZZER_PIN, 800, 80);
    return;
  }

  if (digitalRead(BUTTON_BACK_PIN) == HIGH) {
    button_left_clicked = 0;
  }

  drawEmergencyScreen();
}


// -------------------- LOOP --------------------

void loop() {

  // ---- NEW: reminder popup takes priority over whatever screen is active ----
  if (reminderPopupActive) {
    if (millis() - reminderPopupStart >= REMINDER_POPUP_DURATION) {
      reminderPopupActive = false; // popup+buzzer duration elapsed, fall through to normal screen below
    } else {
      drawReminderPopup();
      return; // skip normal screen handling while the popup is shown
    }
  }

  // ---- NEW: periodic, non-blocking background checks ----
  if (millis() - lastTimeCheckTime >= TIME_CHECK_INTERVAL) {
    lastTimeCheckTime = millis();
    checkReminders();
  }

  if (current_screen == 0) {
    handleMainMenu();
  }
  else if (current_screen == 1) {
    handleGameMenu();
  }
  else if (current_screen == 2) {
    handleYogaMenu();
  }
  else if (current_screen == 3) {
    handleEmergency();
  }
  else if (current_screen == 4) {
    handleReminderMenu();
  }

  // Give FreeRTOS/WiFi background work CPU time without slowing button scans.
  yield();
}
